/**
 * @cliArgs --device "F29H85x" --package "256ZEX" --part "F29H85x_256ZEX" --context "CPU1" --product "MCU_SDK_F29H85x@1.02.02.00"
 * @versions {"tool":"1.25.0+4237"}
 */

/**
 * Import the modules used in this configuration.
 */
const clocktree        = scripting.addModule("/driverlib/clocktree.js");
const esm_system       = scripting.addModule("/driverlib/esm_system.js");
const inputxbar_input  = scripting.addModule("/driverlib/inputxbar_input.js", {}, false);
const inputxbar_input1 = inputxbar_input.addInstance();
const jtag             = scripting.addModule("/driverlib/jtag.js");

/**
 * Write custom configuration values to the imported modules.
 */
const divider4       = system.clockTree["EPWMCLKDIV"];
divider4.divideValue = 1;

const divider15       = system.clockTree["PLL_REFDIV"];
divider15.divideValue = 1;

const multiplier1         = system.clockTree["PLL_IMULT"];
multiplier1.multiplyValue = 40;

const mux7       = system.clockTree["OSCCLKSRCSEL"];
mux7.inputSelect = "INTOSC2";

const mux9       = system.clockTree["XTAL_OR_X1"];
mux9.inputSelect = "XTAL";

const pinFunction3     = system.clockTree["XTAL"];
pinFunction3.XTAL_Freq = 20;

esm_system.errorPinCounterValue    = 0xFFF;
esm_system.errorPinMonitoring      = true;
esm_system.esm.errorstsPin.$assign = "GPIO79";

inputxbar_input1.$name          = "myINPUTXBARINPUT0";
inputxbar_input1.inputxbarInput = "XBAR_INPUT4";
inputxbar_input1.inputxbarGpio  = "GPIO79";


/**
 * Pinmux solution for unlocked pins/peripherals. This ensures that minor changes to the automatic solver in a future
 * version of the tool will not impact the pinmux you originally saw.  These lines can be completely deleted in order to
 * re-solve from scratch.
 */
esm_system.esm.$suggestSolution   = "OTHER";
jtag.JTAG.$suggestSolution        = "JTAG";
jtag.JTAG.tdoPin.$suggestSolution = "GPIO223/TDO";
jtag.JTAG.tdiPin.$suggestSolution = "GPIO222/TDI";
