/**
 * @cliArgs --device "F29H85x" --package "256ZEX" --part "F29H85x_256ZEX" --context "CPU2" --product "MCU_SDK_F29H85x@1.02.02.00"
 * @versions {"tool":"1.25.0+4237"}
 */

/**
 * Import the modules used in this configuration.
 */
const interrupt       = scripting.addModule("/driverlib/interrupt.js");
const rtdma2          = scripting.addModule("/driverlib/rtdma2.js", {}, false);
const rtdma21         = rtdma2.addInstance();
const System_Security = scripting.addModule("/ti/security/System_Security");

/**
 * Write custom configuration values to the imported modules.
 */
interrupt.RTINT_Threshold = 20;

rtdma21.$name                       = "myRTDMA2Ch0";
rtdma21.enableTriggers              = true;
rtdma21.srcAddressInputMode         = "VARIABLE";
rtdma21.srcAddressVariable          = "srcAddr";
rtdma21.destAddressInputMode        = "VARIABLE";
rtdma21.destAddressVariable         = "destAddr";
rtdma21.useInterrupts               = true;
rtdma21.registerInterrupts          = true;
rtdma21.enableInterrupts            = true;
rtdma21.interruptMode               = "DMA_INT_AT_END";
rtdma21.burstSize                   = 4;
rtdma21.transferSize                = 16;
rtdma21.srcBurstStep                = 4;
rtdma21.srcTransferStep             = 4;
rtdma21.destBurstStep               = 4;
rtdma21.destTransferStep            = 4;
rtdma21.rtdma2Int.interruptPriority = 10;

System_Security.module.create(2);
System_Security.module[0].$name                               = "DMA";
System_Security.module[0].periphs_rw                          = ["RTDMA1_CH1_REGS","RTDMA2_CH1_REGS"];
System_Security.module[0].fileNames                           = "dma_cpu2";
System_Security.module[0].codeAPR_RAM.specialAprStatus        = scripting.forceWrite("none");
System_Security.module[0].codeAPR_RAM.type                    = scripting.forceWrite("Code");
System_Security.module[0].codeAPR_RAM.memType                 = scripting.forceWrite("RAM");
System_Security.module[0].codeAPR_RAM.memSize                 = scripting.forceWrite(4);
System_Security.module[0].dataAPR_RW.memType                  = scripting.forceWrite("RAM");
System_Security.module[0].dataAPR_RW.memSize                  = scripting.forceWrite(4);
System_Security.module[0].Link.isLink1                        = scripting.forceWrite(false);
System_Security.module[0].Link.isLink2                        = scripting.forceWrite(false);
System_Security.module[0].Link.readwriteAPRs                  = ["ipc_shared_SHARED_CPU1"];
System_Security.module[1].$name                               = "Comms";
System_Security.module[1].fileNames                           = "comms_cpu2";
System_Security.module[1].periphs_rw                          = ["IPC_CPU2_RECV_REGS_CPU1_CH0_CH1","IPC_CPU2_SEND_REGS_CPU1_CH0_CH1"];
System_Security.module[1].codeAPR_RAM.specialAprStatus        = scripting.forceWrite("none");
System_Security.module[1].codeAPR_RAM.type                    = scripting.forceWrite("Code");
System_Security.module[1].codeAPR_RAM.memType                 = scripting.forceWrite("RAM");
System_Security.module[1].codeAPR_RAM.memSize                 = scripting.forceWrite(4);
System_Security.module[1].dataAPR_RW.memType                  = scripting.forceWrite("RAM");
System_Security.module[1].dataAPR_RW.memSize                  = scripting.forceWrite(4);
System_Security.module[1].Link.isLink1                        = scripting.forceWrite(false);
System_Security.module[1].Link.isLink2                        = scripting.forceWrite(false);
System_Security.LINK2.rodatasize                              = 4;
System_Security.LINK2.fileNames                               = "ssuRTDMA_ex3_basic_cpu1_cpu2_multi_c29x2,system_init_cpu2";
System_Security.LINK2.codesizeRAM                             = 12;
System_Security.LINK2.codeAPR_RAM.type                        = scripting.forceWrite("Code");
System_Security.LINK2.codeAPR_RAM.memType                     = scripting.forceWrite("RAM");
System_Security.LINK2.dataAPR_RW.memType                      = scripting.forceWrite("RAM");
System_Security.LINK2.dataAPR_RW.memSize                      = scripting.forceWrite(4);
System_Security.LINK2.Link.isLink1                            = scripting.forceWrite(false);
System_Security.CommonCodeModule.codesizeRAM                  = 16;
System_Security.CommonCodeModule.rodatasize                   = 4;
System_Security.CommonCodeModule.codeAPR_RAM.specialAprStatus = scripting.forceWrite("none");
System_Security.CommonCodeModule.codeAPR_RAM.type             = scripting.forceWrite("Code");
System_Security.CommonCodeModule.codeAPR_RAM.memType          = scripting.forceWrite("RAM");
System_Security.CommonCodeModule.dataAPR_RW.memType           = scripting.forceWrite("RAM");
System_Security.CommonCodeModule.dataAPR_RW.memSize           = scripting.forceWrite(4);
System_Security.CommonCodeModule.Link.isLink1                 = scripting.forceWrite(false);
System_Security.CommonCodeModule.Link.isLink2                 = scripting.forceWrite(false);
System_Security.LINK1.Link.isLink2                            = scripting.forceWrite(false);
System_Security.STACK1.secGroupAttr                           = "PUBLIC";
System_Security.STACK1.stackMem.type                          = scripting.forceWrite("RAM");
System_Security.STACK1.stackMem.datasize                      = scripting.forceWrite(4);
System_Security.STACK1.stack.size                             = scripting.forceWrite(256);
System_Security.STACK1.stack.zone                             = scripting.forceWrite("ZONE1");
System_Security.STACK1.stack.stackAPR.memType                 = scripting.forceWrite("RAM");
System_Security.STACK2.secGroupAttr                           = "PUBLIC";
System_Security.STACK2.stackMem.type                          = scripting.forceWrite("RAM");
System_Security.STACK2.stackMem.datasize                      = scripting.forceWrite(4);
System_Security.STACK2.stack.size                             = scripting.forceWrite(256);
System_Security.STACK2.stack.zone                             = scripting.forceWrite("ZONE1");
System_Security.STACK2.stack.stackAPR.memType                 = scripting.forceWrite("RAM");
System_Security.sandbox.create(3);
System_Security.sandbox[0].$name                              = "sbox_CommonCode";
System_Security.sandbox[0].modules                            = ["CPU2_CommonCodeModule_Link"];
System_Security.sandbox[0].secGroupAttr                       = "PUBLIC";
System_Security.sandbox[0].stackMem.type                      = scripting.forceWrite("RAM");
System_Security.sandbox[0].stackMem.datasize                  = scripting.forceWrite(4);
System_Security.sandbox[0].stack.size                         = scripting.forceWrite(256);
System_Security.sandbox[0].stack.zone                         = scripting.forceWrite("ZONE1");
System_Security.sandbox[0].stack.stackAPR.memType             = scripting.forceWrite("RAM");
System_Security.sandbox[1].$name                              = "sbox_DMA";
System_Security.sandbox[1].modules                            = ["DMA_Link"];
System_Security.sandbox[1].secGroupAttr                       = "PUBLIC";
System_Security.sandbox[1].stackMem.type                      = scripting.forceWrite("RAM");
System_Security.sandbox[1].stackMem.datasize                  = scripting.forceWrite(4);
System_Security.sandbox[1].stack.size                         = scripting.forceWrite(256);
System_Security.sandbox[1].stack.zone                         = scripting.forceWrite("ZONE1");
System_Security.sandbox[1].stack.stackAPR.memType             = scripting.forceWrite("RAM");
System_Security.sandbox[2].$name                              = "sbox_Comms";
System_Security.sandbox[2].modules                            = ["Comms_Link"];
System_Security.sandbox[2].secGroupAttr                       = "PUBLIC";
System_Security.sandbox[2].stackMem.type                      = scripting.forceWrite("RAM");
System_Security.sandbox[2].stackMem.datasize                  = scripting.forceWrite(4);
System_Security.sandbox[2].stack.size                         = scripting.forceWrite(256);
System_Security.sandbox[2].stack.zone                         = scripting.forceWrite("ZONE1");
System_Security.sandbox[2].stack.stackAPR.memType             = scripting.forceWrite("RAM");

/**
 * References between modules.
 */
System_Security.SECCFG_UPDATE_LINK                  = null;
System_Security.ZONE1_UPDATE_LINK                   = null;
System_Security.ZONE2_UPDATE_LINK                   = null;
System_Security.ZONE3_UPDATE_LINK                   = null;
System_Security.dltLinks                            = [];
System_Security.module[0].interrupts                = [rtdma21.rtdma2Int];
System_Security.module[0].Link.interrupts           = [];
System_Security.module[0].Link.interruptsAPI        = [];
System_Security.module[1].interrupts                = [];
System_Security.module[1].Link.interrupts           = [];
System_Security.module[1].Link.interruptsAPI        = [];
System_Security.LINK2.interrupts                    = [];
System_Security.LINK2.Link.interrupts               = [];
System_Security.LINK2.Link.interruptsAPI            = [];
System_Security.CommonCodeModule.interrupts         = [];
System_Security.CommonCodeModule.Link.interrupts    = [];
System_Security.CommonCodeModule.Link.interruptsAPI = [];
System_Security.LINK1.interrupts                    = [];
System_Security.LINK1.Link.interrupts               = [];
System_Security.LINK1.Link.interruptsAPI            = [];
System_Security.STACK1.stackMem.module_ro           = [];
System_Security.STACK1.stackMem.module_rw           = [];
System_Security.STACK1.stack.links                  = [];
System_Security.STACK2.stackMem.module_ro           = [];
System_Security.STACK2.stackMem.module_rw           = [];
System_Security.STACK2.stack.links                  = [];
System_Security.sandbox[0].stackMem.module_ro       = [];
System_Security.sandbox[0].stackMem.module_rw       = [];
System_Security.sandbox[0].stack.links              = [];
System_Security.sandbox[1].stackMem.module_ro       = [];
System_Security.sandbox[1].stackMem.module_rw       = [];
System_Security.sandbox[1].stack.links              = [];
System_Security.sandbox[2].stackMem.module_ro       = [];
System_Security.sandbox[2].stackMem.module_rw       = [];
System_Security.sandbox[2].stack.links              = [];
