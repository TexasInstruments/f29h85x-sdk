/**
 * @cliArgs --device "F29H85x" --package "256ZEX" --part "F29H85x_256ZEX" --context "CPU1" --product "MCU_SDK_F29H85x@1.02.02.00"
 * @versions {"tool":"1.25.0+4237"}
 */

    
const divider15       = system.clockTree["PLL_REFDIV"];
divider15.divideValue = 1;

const multiplier1         = system.clockTree["PLL_IMULT"];
multiplier1.multiplyValue = 40;

const mux7       = system.clockTree["OSCCLKSRCSEL"];
mux7.inputSelect = "INTOSC2";

/**
 * Import the modules used in this configuration.
 */
const interrupt       = scripting.addModule("/driverlib/interrupt.js");
const rtdma1          = scripting.addModule("/driverlib/rtdma1.js");
const rtdma11         = rtdma1.addInstance();
const rtdma1_mpu      = scripting.addModule("/driverlib/rtdma1_mpu.js");
const rtdma1_mpu1     = rtdma1_mpu.addInstance();
const rtdma1_mpu2     = rtdma1_mpu.addInstance();
const rtdma2          = scripting.addModule("/driverlib/rtdma2.js");
const rtdma2_mpu      = scripting.addModule("/driverlib/rtdma2_mpu.js");
const rtdma2_mpu1     = rtdma2_mpu.addInstance();
const rtdma2_mpu2     = rtdma2_mpu.addInstance();
const sysctl          = scripting.addModule("/driverlib/sysctl.js");
const APR             = scripting.addModule("/ti/security/APR", {}, false);
const APR1            = APR.addInstance();
const System_Security = scripting.addModule("/ti/security/System_Security");

/**
 * Write custom configuration values to the imported modules.
 */
interrupt.RTINT_Threshold = 20;

rtdma1.enableMPU          = true;
rtdma1.periphClock.$name  = "driverlib_perClock0";
rtdma1.periphConfig.$name = "driverlib_perConfig0";

rtdma11.$name                       = "myRTDMA1Ch0";
rtdma11.enableTriggers              = true;
rtdma11.burstSize                   = 4;
rtdma11.transferSize                = 16;
rtdma11.srcBurstStep                = 4;
rtdma11.srcTransferStep             = 4;
rtdma11.srcAddressInputMode         = "VARIABLE";
rtdma11.srcAddressVariable          = "srcAddr2";
rtdma11.destBurstStep               = 4;
rtdma11.destTransferStep            = 4;
rtdma11.destAddressVariable         = "destAddr2";
rtdma11.useInterrupts               = true;
rtdma11.registerInterrupts          = true;
rtdma11.enableInterrupts            = true;
rtdma11.interruptMode               = "DMA_INT_AT_END";
rtdma11.destAddressInputMode        = "VARIABLE";
rtdma11.rtdma1Int.interruptPriority = 10;

rtdma1_mpu1.mpuRegion          = "DMA_MPUR3";
rtdma1_mpu1.$name              = "MPUR_TxData2";
rtdma1_mpu1.accessPermission   = "DMA_MPU_READ_ACCESS";
rtdma1_mpu1.channelMask        = ["DMA_MPU_CH1_ENABLE"];
rtdma1_mpu1.startAddressManual = 0x20143000;
rtdma1_mpu1.endAddressManual   = 0x20143FFF;

rtdma1_mpu2.mpuRegion          = "DMA_MPUR4";
rtdma1_mpu2.$name              = "MPUR_RxData2";
rtdma1_mpu2.accessPermission   = "DMA_MPU_READ_WRITE_ACCESS";
rtdma1_mpu2.channelMask        = ["DMA_MPU_CH1_ENABLE"];
rtdma1_mpu2.startAddressManual = 0x20146000;
rtdma1_mpu2.endAddressManual   = 0x20146FFF;

rtdma2.enableMPU          = true;
rtdma2.periphClock.$name  = "driverlib_perClock1";
rtdma2.periphConfig.$name = "driverlib_perConfig1";

rtdma2_mpu1.channelMask        = ["DMA_MPU_CH1_ENABLE"];
rtdma2_mpu1.accessPermission   = "DMA_MPU_READ_ACCESS";
rtdma2_mpu1.$name              = "MPUR_TxData";
rtdma2_mpu1.startAddressManual = 0x20144000;
rtdma2_mpu1.endAddressManual   = 0x20144FFF;

rtdma2_mpu2.channelMask        = ["DMA_MPU_CH1_ENABLE"];
rtdma2_mpu2.accessPermission   = "DMA_MPU_READ_WRITE_ACCESS";
rtdma2_mpu2.mpuRegion          = "DMA_MPUR2";
rtdma2_mpu2.$name              = "MPUR_RxData";
rtdma2_mpu2.startAddressManual = 0x20145000;
rtdma2_mpu2.endAddressManual   = 0x20145FFF;

sysctl.LSConfig         = "SplitLock";
sysctl.ESM_CPU1CRITICAL = false;

APR1.$name   = "ipc_shared";
APR1.type    = "Data";
APR1.share   = ["CPU2"];
APR1.memSize = 16;

System_Security.cpuList                                         = ["CPU2"];
System_Security.flashLoadSize                                   = 8;
System_Security.module.create(2);
System_Security.module[0].fileNames                             = "dma_cpu1";
System_Security.module[0].periphs_rw                            = ["RTDMA1_CH1_REGS","RTDMA2_CH1_REGS"];
System_Security.module[0].$name                                 = "DMA";
System_Security.module[0].codeAPR_Flash.specialAprStatus        = scripting.forceWrite("none");
System_Security.module[0].codeAPR_Flash.type                    = scripting.forceWrite("Code");
System_Security.module[0].codeAPR_Flash.memSize                 = scripting.forceWrite(4);
System_Security.module[0].codeAPR_RAM.specialAprStatus          = scripting.forceWrite("none");
System_Security.module[0].codeAPR_RAM.type                      = scripting.forceWrite("Code");
System_Security.module[0].codeAPR_RAM.memType                   = scripting.forceWrite("RAM");
System_Security.module[0].codeAPR_RAM.memSize                   = scripting.forceWrite(4);
System_Security.module[0].dataAPR_RW.memType                    = scripting.forceWrite("RAM");
System_Security.module[0].dataAPR_RW.memSize                    = scripting.forceWrite(4);
System_Security.module[0].dataAPR_RO.type                       = scripting.forceWrite("Code");
System_Security.module[0].dataAPR_RO.memSize                    = scripting.forceWrite(4);
System_Security.module[0].Link.isLink1                          = scripting.forceWrite(false);
System_Security.module[0].Link.isLink2                          = scripting.forceWrite(false);
System_Security.module[0].Link.readwriteAPRs                    = ["ipc_shared"];
System_Security.module[1].$name                                 = "Comms";
System_Security.module[1].fileNames                             = "comms_cpu1";
System_Security.module[1].periphs_rw                            = ["IPC_CPU1_RECV_REGS_CPU2_CH0_CH1","IPC_CPU1_SEND_REGS_CPU2_CH0_CH1"];
System_Security.module[1].codeAPR_Flash.specialAprStatus        = scripting.forceWrite("none");
System_Security.module[1].codeAPR_Flash.type                    = scripting.forceWrite("Code");
System_Security.module[1].codeAPR_Flash.memSize                 = scripting.forceWrite(4);
System_Security.module[1].codeAPR_RAM.specialAprStatus          = scripting.forceWrite("none");
System_Security.module[1].codeAPR_RAM.type                      = scripting.forceWrite("Code");
System_Security.module[1].codeAPR_RAM.memType                   = scripting.forceWrite("RAM");
System_Security.module[1].codeAPR_RAM.memSize                   = scripting.forceWrite(4);
System_Security.module[1].dataAPR_RW.memType                    = scripting.forceWrite("RAM");
System_Security.module[1].dataAPR_RW.memSize                    = scripting.forceWrite(4);
System_Security.module[1].dataAPR_RO.type                       = scripting.forceWrite("Code");
System_Security.module[1].dataAPR_RO.memSize                    = scripting.forceWrite(4);
System_Security.module[1].Link.isLink1                          = scripting.forceWrite(false);
System_Security.module[1].Link.isLink2                          = scripting.forceWrite(false);
System_Security.LINK2.fileNames                                 = "ssuRTDMA_ex3_basic_cpu1_cpu2_multi_c29x1,system_init_cpu1";
System_Security.LINK2.codesizeFlash                             = 32;
System_Security.LINK2.codeAPR_Flash.type                        = scripting.forceWrite("Code");
System_Security.LINK2.codeAPR_RAM.type                          = scripting.forceWrite("Code");
System_Security.LINK2.codeAPR_RAM.memType                       = scripting.forceWrite("RAM");
System_Security.LINK2.codeAPR_RAM.memSize                       = scripting.forceWrite(4);
System_Security.LINK2.dataAPR_RW.memType                        = scripting.forceWrite("RAM");
System_Security.LINK2.dataAPR_RW.memSize                        = scripting.forceWrite(4);
System_Security.LINK2.dataAPR_RO.type                           = scripting.forceWrite("Code");
System_Security.LINK2.dataAPR_RO.memSize                        = scripting.forceWrite(4);
System_Security.LINK2.Link.isLink1                              = scripting.forceWrite(false);
System_Security.CommonCodeModule.codesizeFlash                  = 16;
System_Security.CommonCodeModule.codeAPR_Flash.specialAprStatus = scripting.forceWrite("none");
System_Security.CommonCodeModule.codeAPR_Flash.type             = scripting.forceWrite("Code");
System_Security.CommonCodeModule.codeAPR_RAM.specialAprStatus   = scripting.forceWrite("none");
System_Security.CommonCodeModule.codeAPR_RAM.type               = scripting.forceWrite("Code");
System_Security.CommonCodeModule.codeAPR_RAM.memType            = scripting.forceWrite("RAM");
System_Security.CommonCodeModule.codeAPR_RAM.memSize            = scripting.forceWrite(4);
System_Security.CommonCodeModule.dataAPR_RW.memType             = scripting.forceWrite("RAM");
System_Security.CommonCodeModule.dataAPR_RW.memSize             = scripting.forceWrite(4);
System_Security.CommonCodeModule.dataAPR_RO.type                = scripting.forceWrite("Code");
System_Security.CommonCodeModule.dataAPR_RO.memSize             = scripting.forceWrite(4);
System_Security.CommonCodeModule.Link.isLink1                   = scripting.forceWrite(false);
System_Security.CommonCodeModule.Link.isLink2                   = scripting.forceWrite(false);
System_Security.LINK1.Link.isLink2                              = scripting.forceWrite(false);
System_Security.STACK1.secGroupAttr                             = "PUBLIC";
System_Security.STACK1.stackMem.type                            = scripting.forceWrite("RAM");
System_Security.STACK1.stackMem.datasize                        = scripting.forceWrite(4);
System_Security.STACK1.stack.size                               = scripting.forceWrite(256);
System_Security.STACK1.stack.zone                               = scripting.forceWrite("ZONE1");
System_Security.STACK1.stack.stackAPR.memType                   = scripting.forceWrite("RAM");
System_Security.STACK2.secGroupAttr                             = "PUBLIC";
System_Security.STACK2.stackMem.type                            = scripting.forceWrite("RAM");
System_Security.STACK2.stackMem.datasize                        = scripting.forceWrite(4);
System_Security.STACK2.stack.size                               = scripting.forceWrite(256);
System_Security.STACK2.stack.zone                               = scripting.forceWrite("ZONE1");
System_Security.STACK2.stack.stackAPR.memType                   = scripting.forceWrite("RAM");
System_Security.sandbox.create(3);
System_Security.sandbox[0].$name                                = "sbox_CommonCode";
System_Security.sandbox[0].modules                              = ["CPU1_CommonCodeModule_Link"];
System_Security.sandbox[0].secGroupAttr                         = "PUBLIC";
System_Security.sandbox[0].stackMem.type                        = scripting.forceWrite("RAM");
System_Security.sandbox[0].stackMem.datasize                    = scripting.forceWrite(4);
System_Security.sandbox[0].stack.size                           = scripting.forceWrite(256);
System_Security.sandbox[0].stack.zone                           = scripting.forceWrite("ZONE1");
System_Security.sandbox[0].stack.stackAPR.memType               = scripting.forceWrite("RAM");
System_Security.sandbox[1].$name                                = "sbox_DMA";
System_Security.sandbox[1].modules                              = ["DMA_Link"];
System_Security.sandbox[1].secGroupAttr                         = "PUBLIC";
System_Security.sandbox[1].stackMem.type                        = scripting.forceWrite("RAM");
System_Security.sandbox[1].stackMem.datasize                    = scripting.forceWrite(4);
System_Security.sandbox[1].stack.size                           = scripting.forceWrite(256);
System_Security.sandbox[1].stack.zone                           = scripting.forceWrite("ZONE1");
System_Security.sandbox[1].stack.stackAPR.memType               = scripting.forceWrite("RAM");
System_Security.sandbox[2].$name                                = "sbox_Comms";
System_Security.sandbox[2].modules                              = ["Comms_Link"];
System_Security.sandbox[2].secGroupAttr                         = "PUBLIC";
System_Security.sandbox[2].stackMem.type                        = scripting.forceWrite("RAM");
System_Security.sandbox[2].stackMem.datasize                    = scripting.forceWrite(4);
System_Security.sandbox[2].stack.size                           = scripting.forceWrite(256);
System_Security.sandbox[2].stack.zone                           = scripting.forceWrite("ZONE1");
System_Security.sandbox[2].stack.stackAPR.memType               = scripting.forceWrite("RAM");

/**
 * References between modules.
 */
System_Security.SECCFG_UPDATE_LINK                  = null;
System_Security.ZONE1_UPDATE_LINK                   = null;
System_Security.ZONE2_UPDATE_LINK                   = null;
System_Security.ZONE3_UPDATE_LINK                   = null;
System_Security.dltLinks                            = [];
System_Security.module[0].interrupts                = [rtdma11.rtdma1Int];
System_Security.module[0].Link.interrupts           = [];
System_Security.module[0].Link.interruptsAPI        = [];
System_Security.module[1].interrupts                = [];
System_Security.module[1].Link.interrupts           = [];
System_Security.module[1].Link.interruptsAPI        = [];
System_Security.LINK2.interrupts                    = [];
System_Security.LINK2.Link.interrupts               = [];
System_Security.LINK2.Link.interruptsAPI            = [];
System_Security.CommonCodeModule.interrupts         = [];
System_Security.CommonCodeModule.Link.interrupts    = [];
System_Security.CommonCodeModule.Link.interruptsAPI = [];
System_Security.LINK1.interrupts                    = [];
System_Security.LINK1.Link.interrupts               = [];
System_Security.LINK1.Link.interruptsAPI            = [];
System_Security.STACK1.stackMem.module_ro           = [];
System_Security.STACK1.stackMem.module_rw           = [];
System_Security.STACK1.stack.links                  = [];
System_Security.STACK2.stackMem.module_ro           = [];
System_Security.STACK2.stackMem.module_rw           = [];
System_Security.STACK2.stack.links                  = [];
System_Security.sandbox[0].stackMem.module_ro       = [];
System_Security.sandbox[0].stackMem.module_rw       = [];
System_Security.sandbox[0].stack.links              = [];
System_Security.sandbox[1].stackMem.module_ro       = [];
System_Security.sandbox[1].stackMem.module_rw       = [];
System_Security.sandbox[1].stack.links              = [];
System_Security.sandbox[2].stackMem.module_ro       = [];
System_Security.sandbox[2].stackMem.module_rw       = [];
System_Security.sandbox[2].stack.links              = [];
