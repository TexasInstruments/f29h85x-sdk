/**
 * These arguments were used when this file was generated. They will be automatically applied on subsequent loads
 * via the GUI or CLI. Run CLI with '--help' for additional information on how to override these arguments.
 * @cliArgs --device "F29H85x" --package "256ZEX" --part "F29H85x_256ZEX" --context "CPU2" --product "MCU_SDK_F29H85x@1.00.00.00"
 * @v2CliArgs --device "F29H850TU" --package "256ZEX" --variant "TMS320F29H850TU9" --context "CPU2" --product "MCU_SDK_F29H85x@1.00.00.00"
 * @versions {"tool":"1.22.0+3877"}
 */

/**
 * Import the modules used in this configuration.
 */
const ipc = scripting.addModule("/driverlib/ipc.js");

/**
 * Write custom configuration values to the imported modules.
 */
ipc.registerInterrupts0 = ["0"];
