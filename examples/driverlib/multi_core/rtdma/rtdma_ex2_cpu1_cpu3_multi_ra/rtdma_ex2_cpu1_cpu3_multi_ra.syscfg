/**
 * @cliArgs --device "F29H85x" --part "F29H85x_256ZEX" --package "256ZEX" --context "system" --product "MCU_SDK_F29H85x@1.02.02.00"
 * @versions {"tool":"1.25.0+4238"}
 */

/**
 * Import the modules used in this configuration.
 */
const clocktree = scripting.addModule("/driverlib/clocktree.js");
const epwm      = scripting.addModule("/driverlib/epwm.js", {}, false);
const epwm1     = epwm.addInstance();
const jtag      = scripting.addModule("/driverlib/jtag.js");
const rtdma1    = scripting.addModule("/driverlib/rtdma1.js");
const rtdma11   = rtdma1.addInstance();
const spi       = scripting.addModule("/driverlib/spi.js", {}, false);
const spi1      = spi.addInstance();

/**
 * Write custom configuration values to the imported modules.
 */
const divider15       = system.clockTree["PLL_REFDIV"];
divider15.divideValue = 1;

const multiplier1         = system.clockTree["PLL_IMULT"];
multiplier1.multiplyValue = 40;

const mux7       = system.clockTree["OSCCLKSRCSEL"];
mux7.inputSelect = "INTOSC2";

epwm1.$name              = "myEPWM0";
epwm1.epwm.$assign       = "EPWM1";
epwm1.periphClock.$name  = "driverlib_perClock1";
epwm1.periphConfig.$name = "driverlib_perConfig1";


rtdma1.enableSoftwarePriority = true;
rtdma1.periphClock.$name      = "driverlib_perClock0";
rtdma1.periphConfig.$name     = "driverlib_perConfig0";

rtdma11.$name            = "myRTDMA1Ch0";
rtdma11.$assignedContext = "CPU3";

spi1.$name                       = "mySPI0";
spi1.$assignedContext            = "CPU3";
spi1.picoQual.$name              = "myGPIOQUAL0";
spi1.pociQual.$name              = "myGPIOQUAL1";
spi1.clkQual.$name               = "myGPIOQUAL2";
spi1.pteQual.$name               = "myGPIOQUAL3";
spi1.periphClock.$name           = "driverlib_perClock2";
spi1.periphConfig.$name          = "driverlib_perConfig2";
spi1.periphConfig.peripheralInst = scripting.forceWrite("");

/**
 * Pinmux solution for unlocked pins/peripherals. This ensures that minor changes to the automatic solver in a future
 * version of the tool will not impact the pinmux you originally saw.  These lines can be completely deleted in order to
 * re-solve from scratch.
 */
epwm1.epwm.epwm_aPin.$suggestSolution = "GPIO0";
epwm1.epwm.epwm_bPin.$suggestSolution = "GPIO1";
jtag.JTAG.$suggestSolution            = "JTAG";
jtag.JTAG.tdoPin.$suggestSolution     = "GPIO223/TDO";
jtag.JTAG.tdiPin.$suggestSolution     = "GPIO222/TDI";
spi1.spi.$suggestSolution             = "SPIA";
spi1.spi.spi_picoPin.$suggestSolution = "B7/E27, GPIO231";
spi1.spi.spi_pociPin.$suggestSolution = "B8, GPIO232";
spi1.spi.spi_clkPin.$suggestSolution  = "A9, GPIO227";
spi1.spi.spi_ptePin.$suggestSolution  = "A8, GPIO226";
