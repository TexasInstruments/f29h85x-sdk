/**
 * @cliArgs --board "/boards/HSEC180ADAPEVM-F29H85X-SOM" --context "system" --product "MCU_SDK_F29H85x@1.02.02.00"
 * @versions {"tool":"1.25.0+4238"}
 */

/**
 * Import the modules used in this configuration.
 */
const led       = scripting.addModule("/driverlib/board_components/led", {}, false);
const led1      = led.addInstance();
const led2      = led.addInstance();
const clocktree = scripting.addModule("/driverlib/clocktree.js");
const jtag      = scripting.addModule("/driverlib/jtag.js");

/**
 * Write custom configuration values to the imported modules.
 */
led1.$name     = "CPU1_LED";
led1.$hardware = system.deviceData.board.components.USER_LEDS.subComponents.USER_LED0;

led2.$name            = "CPU3_LED";
led2.$assignedContext = "CPU3";
led2.$hardware        = system.deviceData.board.components.USER_LEDS.subComponents.USER_LED1;

const divider15       = system.clockTree["PLL_REFDIV"];
divider15.divideValue = 1;

const multiplier1         = system.clockTree["PLL_IMULT"];
multiplier1.multiplyValue = 40;

const mux7       = system.clockTree["OSCCLKSRCSEL"];
mux7.inputSelect = "INTOSC2";


/**
 * Pinmux solution for unlocked pins/peripherals. This ensures that minor changes to the automatic solver in a future
 * version of the tool will not impact the pinmux you originally saw.  These lines can be completely deleted in order to
 * re-solve from scratch.
 */
led1.gpio.gpioPin.$suggestSolution = "hsecDigital.89";
led2.gpio.gpioPin.$suggestSolution = "hsecDigital.91";
jtag.JTAG.$suggestSolution         = "JTAG";
jtag.JTAG.tdoPin.$suggestSolution  = "hsecAnalog.6";
jtag.JTAG.tdiPin.$suggestSolution  = "hsecAnalog.8";
