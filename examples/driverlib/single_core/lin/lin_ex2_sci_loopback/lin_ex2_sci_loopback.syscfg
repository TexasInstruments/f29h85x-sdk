/**
 * @cliArgs --device "F29H85x" --package "256ZEX" --part "F29H85x_256ZEX" --context "CPU1" --product "MCU_SDK_F29H85x@1.00.00.00"
 * @versions {"tool":"1.22.0+3877"}
 */

const divider15       = system.clockTree["PLL_REFDIV"];
divider15.divideValue = 1;

const multiplier1         = system.clockTree["PLL_IMULT"];
multiplier1.multiplyValue = 40;

const mux7       = system.clockTree["OSCCLKSRCSEL"];
mux7.inputSelect = "INTOSC2";

/**
 * Import the modules used in this configuration.
 */
const jtag = scripting.addModule("/driverlib/jtag.js");
const lin  = scripting.addModule("/driverlib/lin.js", {}, false);
const lin1 = lin.addInstance();

/**
 * Write custom configuration values to the imported modules.
 */

lin1.$name                      = "myLIN0";
lin1.opMode                     = "SCI";
lin1.enableLoopback             = true;
lin1.enableInterrupt            = true;
lin1.sciInterruptFlags          = ["LIN_SCI_INT_RX"];
lin1.sciInterruptLine           = ["LIN_INTERRUPT_LINE0"];
lin1.sciInterruptPriorityLine0  = ["LIN_SCI_INT_RX"];
lin1.registerL0Int              = true;
lin1.periphClock.$name          = "driverlib_perClock0";
lin1.periphConfig.$name         = "driverlib_perConfig0";
lin1.level0Int.interruptHandler = "dataRxISR";
