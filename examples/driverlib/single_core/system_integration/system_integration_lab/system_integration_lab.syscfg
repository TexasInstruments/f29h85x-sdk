/**
 * @cliArgs --device "F29H85x" --package "256ZEX" --part "F29H85x_256ZEX" --context "CPU1" --product "MCU_SDK_F29H85x@1.02.02.00"
 * @versions {"tool":"1.25.0+4237"}
 */

    
const divider15       = system.clockTree["PLL_REFDIV"];
divider15.divideValue = 1;

const multiplier1         = system.clockTree["PLL_IMULT"];
multiplier1.multiplyValue = 40;

const mux7       = system.clockTree["OSCCLKSRCSEL"];
mux7.inputSelect = "INTOSC2";

/**
 * Import the modules used in this configuration.
 */
const adc        = scripting.addModule("/driverlib/adc.js", {}, false);
const adc1       = adc.addInstance();
const analog     = scripting.addModule("/driverlib/analog.js", {}, false);
const analog1    = analog.addInstance();
const asysctl    = scripting.addModule("/driverlib/asysctl.js");
const led        = scripting.addModule("/driverlib/board_components/led", {}, false);
const led1       = led.addInstance();
const cmpss      = scripting.addModule("/driverlib/cmpss.js", {}, false);
const cmpss1     = cmpss.addInstance();
const dac        = scripting.addModule("/driverlib/dac.js", {}, false);
const dac1       = dac.addInstance();
const epwm       = scripting.addModule("/driverlib/epwm.js", {}, false);
const epwm1      = epwm.addInstance();
const epwmxbar   = scripting.addModule("/driverlib/epwmxbar.js", {}, false);
const epwmxbar1  = epwmxbar.addInstance();
const esm_system = scripting.addModule("/driverlib/esm_system.js");
const jtag       = scripting.addModule("/driverlib/jtag.js");
const sync       = scripting.addModule("/driverlib/sync.js", {}, false);
const sync1      = sync.addInstance();

/**
 * Write custom configuration values to the imported modules.
 */
adc1.$name                = "myADCA";
adc1.adcClockPrescaler    = "ADC_CLK_DIV_4_0";
adc1.enabledSOCs          = ["ADC_SOC_NUMBER0"];
adc1.soc0Trigger          = "ADC_TRIGGER_EPWM1_SOCA";
adc1.soc0InterruptTrigger = "ADC_INT_SOC_TRIGGER_ADCINT1";
adc1.interruptPulseMode   = "ADC_PULSE_END_OF_CONV";
adc1.enabledInts          = ["ADC_INT_NUMBER1"];
adc1.enableInterrupt1     = true;
adc1.registerInterrupts   = ["1"];
adc1.soc0Channel          = "ADC_CH_ADCIN4";
adc1.periphClock.$name    = "driverlib_perClock0";
adc1.periphConfig.$name   = "driverlib_perConfig0";

asysctl.analogReferenceAB = "INTERNAL_3_3_V";

led1.$name                = "myBoardLED0";
led1.gpio.gpioPin.$assign = "GPIO23";

cmpss1.$name              = "myCMPSS";
cmpss1.enableModule       = true;
cmpss1.dacValHigh         = 2500;
cmpss1.periphClock.$name  = "driverlib_perClock1";
cmpss1.periphConfig.$name = "driverlib_perConfig1";

dac1.$name              = "myDACA";
dac1.referenceVoltage   = "DAC_REF_ADC_VREFHI";
dac1.enableOutput       = true;
dac1.gainMode           = "DAC_GAIN_TWO";
dac1.periphClock.$name  = "driverlib_perClock2";
dac1.periphConfig.$name = "driverlib_perConfig2";

analog1.$name            = "myANALOGPinMux0";
adc1.analog              = analog1;
analog1.useCase          = "CUSTOM";
cmpss1.analog            = analog1;
dac1.analog              = analog1;
analog1.useInterfacePins = ["A0/C24/DACA_OUT","A4/D28"];

epwm1.$name                                                      = "myEPWM1";
epwm1.epwmTimebase_hsClockDiv                                    = "EPWM_HSCLOCK_DIVIDER_1";
epwm1.epwmTimebase_period                                        = 1000;
epwm1.epwmCounterCompare_cmpA                                    = 500;
epwm1.epwmActionQualifier_EPWM_AQ_OUTPUT_A_ON_TIMEBASE_UP_CMPA   = "EPWM_AQ_OUTPUT_HIGH";
epwm1.epwmActionQualifier_EPWM_AQ_OUTPUT_A_ON_TIMEBASE_DOWN_CMPA = "EPWM_AQ_OUTPUT_LOW";
epwm1.epwmTimebase_counterMode                                   = "EPWM_COUNTER_MODE_UP_DOWN";
epwm1.epwmTripZone_EPWM_TZ_ACTION_EVENT_TZA                      = "EPWM_TZ_ACTION_LOW";
epwm1.epwmTripZone_oneShotSource                                 = ["EPWM_TZ_SIGNAL_DCAEVT1"];
epwm1.epwmDigitalCompare_EPWM_DC_TYPE_DCAH                       = "EPWM_DC_TRIP_TRIPIN4";
epwm1.epwmDigitalCompare_EPWM_TZ_DC_OUTPUT_A1                    = "EPWM_TZ_EVENT_DCXH_HIGH";
epwm1.epwmEventTrigger_EPWM_SOC_A_triggerEnable                  = true;
epwm1.epwmEventTrigger_EPWM_SOC_A_triggerSource                  = "EPWM_SOC_TBCTR_U_CMPA";
epwm1.epwmEventTrigger_EPWM_SOC_A_triggerEventPrescalar          = "1";
epwm1.periphClock.$name                                          = "driverlib_perClock3";
epwm1.periphConfig.$name                                         = "driverlib_perConfig3";

epwmxbar1.tripInput                                  = "XBAR_TRIP4";
epwmxbar1.configureESM                               = true;
epwmxbar1.$name                                      = "myEPWMXBAR4";
epwmxbar1.sourceSignals                              = ["CMPSS1_CTRIPH"];
epwmxbar1.ESMConfig.inSysEsm                         = true;
epwmxbar1.ESMConfig.esmSys.enableInfluenceOnErrorPin = true;



sync1.$name         = "mySYNC0";
sync1.syncOutSource = ["SYSCTL_SYNC_OUT_SRC_EPWM1SYNCOUT"];

/**
 * Pinmux solution for unlocked pins/peripherals. This ensures that minor changes to the automatic solver in a future
 * version of the tool will not impact the pinmux you originally saw.  These lines can be completely deleted in order to
 * re-solve from scratch.
 */
analog1.analog.$suggestSolution                       = "ANALOG";
analog1.analog["a0/c24/daca_outPin"].$suggestSolution = "A0/C24/DACA_OUT";
analog1.analog["a4/d28Pin"].$suggestSolution          = "A4/D28";
epwm1.epwm.$suggestSolution                           = "EPWM1";
epwm1.epwm.epwm_aPin.$suggestSolution                 = "GPIO0";
epwm1.epwm.epwm_bPin.$suggestSolution                 = "GPIO1";
esm_system.esm.$suggestSolution                       = "OTHER";
esm_system.esm.errorstsPin.$suggestSolution           = "E5/A29, GPIO247";
jtag.JTAG.$suggestSolution                            = "JTAG";
jtag.JTAG.tdoPin.$suggestSolution                     = "GPIO223/TDO";
jtag.JTAG.tdiPin.$suggestSolution                     = "GPIO222/TDI";
sync1.SYNC.$suggestSolution                           = "OTHER";
