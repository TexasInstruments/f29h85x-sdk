/**
 * @cliArgs --device "F29H85x" --package "256ZEX" --part "F29H85x_256ZEX" --context "CPU1" --product "MCU_SDK_F29H85x@1.00.00.00"
 * @versions {"tool":"1.22.0+3877"}
 */

const divider15       = system.clockTree["PLL_REFDIV"];
divider15.divideValue = 1;

const multiplier1         = system.clockTree["PLL_IMULT"];
multiplier1.multiplyValue = 40;

const mux7       = system.clockTree["OSCCLKSRCSEL"];
mux7.inputSelect = "INTOSC2";

/**
 * Import the modules used in this configuration.
 */
const esm_cpu     = scripting.addModule("/driverlib/esm_cpu.js");
const interrupt   = scripting.addModule("/driverlib/interrupt.js");
const jtag        = scripting.addModule("/driverlib/jtag.js");
const rtdma1      = scripting.addModule("/driverlib/rtdma1.js");
const rtdma11     = rtdma1.addInstance();
const rtdma1_mpu  = scripting.addModule("/driverlib/rtdma1_mpu.js");
const rtdma1_mpu1 = rtdma1_mpu.addInstance();

/**
 * Write custom configuration values to the imported modules.
 */
esm_cpu.registerNMI = true;

interrupt.RTINT_Threshold = 80;


rtdma1.enableSoftwarePriority           = true;
rtdma1.lockDMAConfig                    = true;
rtdma1.enableMPU                        = true;
rtdma1.configureESMforHPERR             = true;
rtdma1.periphClock.$name                = "driverlib_perClock0";
rtdma1.periphConfig.$name               = "driverlib_perConfig0";
rtdma1.ESMConfigHPERR.inCpu1Esm         = true;
rtdma1.ESMConfigHPERR.esmCPU1.enableNMI = true;

rtdma11.$name                = "myRTDMA1Ch0";
rtdma11.enableTriggers       = true;
rtdma11.channelPriority      = "DMA_CHPRIORITY2";
rtdma11.useInterrupts        = true;
rtdma11.registerInterrupts   = true;
rtdma11.enableInterrupts     = true;
rtdma11.databusWidthConfig   = "DMA_CFG_READ_SIZE_32BIT";
rtdma11.writeDatasizeConfig  = "DMA_CFG_WRT_SIZE_32BIT";
rtdma11.interruptMode        = "DMA_INT_AT_END";
rtdma11.burstSize            = 4;
rtdma11.transferSize         = 16;
rtdma11.srcAddressInputMode  = "VARIABLE";
rtdma11.srcAddressVariable   = "srcAddr";
rtdma11.srcBurstStep         = 4;
rtdma11.srcTransferStep      = 4;
rtdma11.destAddressInputMode = "VARIABLE";
rtdma11.destAddressVariable  = "destAddr";
rtdma11.destBurstStep        = 4;
rtdma11.destTransferStep     = 4;

rtdma1_mpu.lockMPUConfig = true;

rtdma1_mpu1.$name              = "myRTDMA1MPU0";
rtdma1_mpu1.lockMPURegion      = true;
rtdma1_mpu1.accessPermission   = "DMA_MPU_READ_WRITE_ACCESS";
rtdma1_mpu1.startAddressManual = 0x200E0000;
rtdma1_mpu1.endAddressManual   = 0x200E0FFF;
rtdma1_mpu1.channelMask        = ["DMA_MPU_CH10_ENABLE","DMA_MPU_CH1_ENABLE","DMA_MPU_CH2_ENABLE","DMA_MPU_CH3_ENABLE","DMA_MPU_CH4_ENABLE","DMA_MPU_CH5_ENABLE","DMA_MPU_CH6_ENABLE","DMA_MPU_CH7_ENABLE","DMA_MPU_CH8_ENABLE","DMA_MPU_CH9_ENABLE"];
