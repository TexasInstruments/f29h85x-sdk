/**
 * @cliArgs --device "F29H85x" --package "256ZEX" --part "F29H85x_256ZEX" --context "CPU1" --product "MCU_SDK_F29H85x@1.00.00.00"
 * @versions {"tool":"1.22.0+3877"}
 */

const divider15       = system.clockTree["PLL_REFDIV"];
divider15.divideValue = 1;

const multiplier1         = system.clockTree["PLL_IMULT"];
multiplier1.multiplyValue = 40;

const mux7       = system.clockTree["OSCCLKSRCSEL"];
mux7.inputSelect = "INTOSC2";

/**
 * Import the modules used in this configuration.
 */
const cputimer  = scripting.addModule("/driverlib/cputimer.js", {}, false);
const cputimer1 = cputimer.addInstance();
const cputimer2 = cputimer.addInstance();
const cputimer3 = cputimer.addInstance();
const jtag      = scripting.addModule("/driverlib/jtag.js");

/**
 * Write custom configuration values to the imported modules.
 */
cputimer1.$name              = "myCPUTIMER0";
cputimer1.timerPeriod        = 100000;
cputimer1.enableInterrupt    = true;
cputimer1.registerInterrupts = true;
cputimer1.periphClock.$name  = "driverlib_perClock0";

cputimer2.$name                              = "myCPUTIMER1";
cputimer2.cputimerBase                       = "CPUTIMER1_BASE";
cputimer2.timerPeriod                        = 200000;
cputimer2.enableInterrupt                    = true;
cputimer2.registerInterrupts                 = true;
cputimer2.periphClock.$name                  = "driverlib_perClock1";
cputimer2.periphClock.pinmuxPeripheralModule = scripting.forceWrite("");

cputimer3.$name                              = "myCPUTIMER2";
cputimer3.cputimerBase                       = "CPUTIMER2_BASE";
cputimer3.timerPeriod                        = 400000;
cputimer3.enableInterrupt                    = true;
cputimer3.registerInterrupts                 = true;
cputimer3.periphClock.$name                  = "driverlib_perClock2";
cputimer3.periphClock.pinmuxPeripheralModule = scripting.forceWrite("");


/**
 * Pinmux solution for unlocked pins/peripherals. This ensures that minor changes to the automatic solver in a future
 * version of the tool will not impact the pinmux you originally saw.  These lines can be completely deleted in order to
 * re-solve from scratch.
 */
jtag.JTAG.$suggestSolution        = "JTAG";
jtag.JTAG.tdoPin.$suggestSolution = "GPIO223/TDO";
jtag.JTAG.tdiPin.$suggestSolution = "GPIO222/TDI";
