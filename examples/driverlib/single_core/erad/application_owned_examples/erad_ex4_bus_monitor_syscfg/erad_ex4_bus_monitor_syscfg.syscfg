/**
 * @cliArgs --device "F29H85x" --package "256ZEX" --part "F29H85x_256ZEX" --context "CPU1" --product "MCU_SDK_F29H85x@1.00.00.00"
 * @versions {"tool":"1.22.0+3877"}
 */

const divider15       = system.clockTree["PLL_REFDIV"];
divider15.divideValue = 1;

const multiplier1         = system.clockTree["PLL_IMULT"];
multiplier1.multiplyValue = 40;

const mux7       = system.clockTree["OSCCLKSRCSEL"];
mux7.inputSelect = "INTOSC2";

/**
 * Import the modules used in this configuration.
 */
const erad  = scripting.addModule("/driverlib/erad.js");
const jtag  = scripting.addModule("/driverlib/jtag.js");

/**
 * Write custom configuration values to the imported modules.
 */
erad.registerInterrupts                  = true;
erad.periphClock.$name                   = "driverlib_perClock0";
erad.erad_buscomp.create(3);
erad.erad_buscomp[0].$name               = "myERAD_BUSCOMP0";
erad.erad_buscomp[0].instance            = "ERAD_BUSCOMP7";
erad.erad_buscomp[0].ebcBusSel           = "ERAD_BUSCOMP_BUS_VPC_I_ALIGNED";
erad.erad_buscomp[0].ebcAddressInputMode = "CODE";
erad.erad_buscomp[0].ebcRefCodeName      = "addr_delayFunction";
erad.erad_buscomp[1].$name               = "myERAD_BUSCOMP1";
erad.erad_buscomp[1].instance            = "ERAD_BUSCOMP6";
erad.erad_buscomp[1].ebcBusSel           = "ERAD_BUSCOMP_BUS_DRAB_W";
erad.erad_buscomp[1].ebcAddressInputMode = "CODE";
erad.erad_buscomp[1].ebcRefCodeName      = "addr_startCount";
erad.erad_buscomp[1].interrupt           = true;
erad.erad_buscomp[2].$name               = "myERAD_BUSCOMP2";
erad.erad_buscomp[2].instance            = "ERAD_BUSCOMP5";
erad.erad_buscomp[2].ebcBusSel           = "ERAD_BUSCOMP_BUS_DWAB";
erad.erad_buscomp[2].ebcAddressInputMode = "CODE";
erad.erad_buscomp[2].ebcRefCodeName      = "addr_endCount";
erad.erad_buscomp[2].interrupt           = true;
erad.erad_counter.create(1);
erad.erad_counter[0].$name               = "myERAD_COUNTER0";
erad.erad_counter[0].clockSource         = "1";
erad.erad_counter[0].externalClockSource = "ERAD_EVENT_EBC7";


/**
 * Pinmux solution for unlocked pins/peripherals. This ensures that minor changes to the automatic solver in a future
 * version of the tool will not impact the pinmux you originally saw.  These lines can be completely deleted in order to
 * re-solve from scratch.
 */
jtag.JTAG.$suggestSolution        = "JTAG";
jtag.JTAG.tdoPin.$suggestSolution = "GPIO223/TDO";
jtag.JTAG.tdiPin.$suggestSolution = "GPIO222/TDI";
