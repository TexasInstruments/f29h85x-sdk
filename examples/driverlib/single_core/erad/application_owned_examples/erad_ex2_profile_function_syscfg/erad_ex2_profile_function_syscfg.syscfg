/**
 * @cliArgs --device "F29H85x" --package "256ZEX" --part "F29H85x_256ZEX" --context "CPU1" --product "MCU_SDK_F29H85x@1.02.02.00"
 * @versions {"tool":"1.25.0+4237"}
 */

    
const divider15       = system.clockTree["PLL_REFDIV"];
divider15.divideValue = 1;

const multiplier1         = system.clockTree["PLL_IMULT"];
multiplier1.multiplyValue = 40;

const mux7       = system.clockTree["OSCCLKSRCSEL"];
mux7.inputSelect = "INTOSC2";

/**
 * Import the modules used in this configuration.
 */
const erad  = scripting.addModule("/driverlib/erad.js");
const jtag  = scripting.addModule("/driverlib/jtag.js");

/**
 * Write custom configuration values to the imported modules.
 */
erad.periphClock.$name                   = "driverlib_perClock0";
erad.erad_buscomp.create(4);
erad.erad_buscomp[0].$name               = "myERAD_BUSCOMP0";
erad.erad_buscomp[0].instance            = "ERAD_BUSCOMP7";
erad.erad_buscomp[0].ebcBusSel           = "ERAD_BUSCOMP_BUS_VPC_I_ALIGNED";
erad.erad_buscomp[0].ebcAddressInputMode = "CODE";
erad.erad_buscomp[0].ebcRefCodeName      = "addr_delayFuncStart";
erad.erad_buscomp[1].$name               = "myERAD_BUSCOMP1";
erad.erad_buscomp[1].instance            = "ERAD_BUSCOMP6";
erad.erad_buscomp[1].ebcBusSel           = "ERAD_BUSCOMP_BUS_VPC_I_ALIGNED";
erad.erad_buscomp[1].ebcAddressInputMode = "CODE";
erad.erad_buscomp[1].ebcRefCodeName      = "addr_delayFuncEnd";
erad.erad_buscomp[2].$name               = "myERAD_BUSCOMP2";
erad.erad_buscomp[2].instance            = "ERAD_BUSCOMP5";
erad.erad_buscomp[2].ebcBusSel           = "ERAD_BUSCOMP_BUS_DWAB";
erad.erad_buscomp[2].ebcAddressInputMode = "CODE";
erad.erad_buscomp[2].ebcRefCodeName      = "addr_startCount";
erad.erad_buscomp[3].$name               = "myERAD_BUSCOMP3";
erad.erad_buscomp[3].instance            = "ERAD_BUSCOMP4";
erad.erad_buscomp[3].ebcBusSel           = "ERAD_BUSCOMP_BUS_DWAB";
erad.erad_buscomp[3].ebcAddressInputMode = "CODE";
erad.erad_buscomp[3].ebcRefCodeName      = "addr_endCount";
erad.erad_counter.create(2);
erad.erad_counter[0].$name               = "myERAD_COUNTER0";
erad.erad_counter[0].secMode             = "1";
erad.erad_counter[0].swStart             = "ERAD_EVENT_EBC7";
erad.erad_counter[0].swStop              = "ERAD_EVENT_EBC6";
erad.erad_counter[1].$name               = "myERAD_COUNTER1";
erad.erad_counter[1].secMode             = "1";
erad.erad_counter[1].instance            = "ERAD_COUNTER1";
erad.erad_counter[1].swStart             = "ERAD_EVENT_EBC5";
erad.erad_counter[1].swStop              = "ERAD_EVENT_EBC4";


/**
 * Pinmux solution for unlocked pins/peripherals. This ensures that minor changes to the automatic solver in a future
 * version of the tool will not impact the pinmux you originally saw.  These lines can be completely deleted in order to
 * re-solve from scratch.
 */
jtag.JTAG.$suggestSolution        = "JTAG";
jtag.JTAG.tdoPin.$suggestSolution = "GPIO223/TDO";
jtag.JTAG.tdiPin.$suggestSolution = "GPIO222/TDI";
