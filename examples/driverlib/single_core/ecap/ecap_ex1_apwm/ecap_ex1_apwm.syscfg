/**
 * @cliArgs --device "F29H85x" --package "256ZEX" --part "F29H85x_256ZEX" --context "CPU1" --product "MCU_SDK_F29H85x@1.00.00.00"
 * @versions {"tool":"1.22.0+3877"}
 */

const divider15       = system.clockTree["PLL_REFDIV"];
divider15.divideValue = 1;

const multiplier1         = system.clockTree["PLL_IMULT"];
multiplier1.multiplyValue = 40;

const mux7       = system.clockTree["OSCCLKSRCSEL"];
mux7.inputSelect = "INTOSC2";

/**
 * Import the modules used in this configuration.
 */
const jtag  = scripting.addModule("/driverlib/jtag.js");
const ecap        = scripting.addModule("/driverlib/ecap.js", {}, false);
const ecap1       = ecap.addInstance();
const outputxbar  = scripting.addModule("/driverlib/outputxbar.js", {}, false);
const outputxbar1 = outputxbar.addInstance();

/**
 * Write custom configuration values to the imported modules.
 */
ecap1.$name       = "myECAP0";
ecap1.ecapMode    = "APWM";
ecap1.apwmPeriod  = 20000000;
ecap1.apwmCompare = 10000000;

outputxbar1.$name                            = "myOUTPUTXBAR0";
outputxbar1.sourceSignals                    = ["ECAP1_OUT"];
outputxbar1.outputxbar.$assign               = "OUTPUTXBAR3";
outputxbar1.outputxbar.outputxbarPin.$assign = "GPIO5";
