/**
 * @cliArgs --device "F29H85x" --package "256ZEX" --part "F29H85x_256ZEX" --context "CPU1" --product "MCU_SDK_F29H85x@1.02.02.00"
 * @versions {"tool":"1.25.0+4237"}
 */

    
const divider15       = system.clockTree["PLL_REFDIV"];
divider15.divideValue = 1;

const multiplier1         = system.clockTree["PLL_IMULT"];
multiplier1.multiplyValue = 40;

const mux7       = system.clockTree["OSCCLKSRCSEL"];
mux7.inputSelect = "INTOSC2";


/**
 * Import the modules used in this configuration.
 */
const jtag  = scripting.addModule("/driverlib/jtag.js");
const mcan  = scripting.addModule("/driverlib/mcan.js", {}, false);
const mcan1 = mcan.addInstance();

/**
 * Write custom configuration values to the imported modules.
 */


mcan1.$name                     = "myMCAN0";
mcan1.enableInterrupt           = true;
mcan1.interruptFlags            = ["MCAN_INTR_MASK_ALL"];
mcan1.interruptLine             = ["MCAN_INTR_LINE_NUM_1"];
mcan1.interruptLine1Flag        = ["MCAN_INTR_MASK_ALL"];
mcan1.registerInterruptLine1    = true;
mcan1.registerInterruptLine0    = true;
mcan1.additionalCoreConfig      = true;
mcan1.stdFiltsUsed              = [0];
mcan1.txBufNum                  = 4;
mcan1.txFIFOSize                = 6;
mcan1.txEventFIFOWaterMark      = 6;
mcan1.rxFIFO0waterMark          = 6;
mcan1.rxFIFO1waterMark          = 6;
mcan1.nomRatePrescalar          = 0;
mcan1.nomTimeSeg1               = 9;
mcan1.nomTimeSeg2               = 8;
mcan1.nomSynchJumpWidth         = 8;
mcan1.dataRatePrescalar         = 0;
mcan1.periphClock.$name         = "driverlib_perClock0";
mcan1.periphConfig.$name        = "driverlib_perConfig0";
mcan1.mcanInt1.interruptHandler = "MCANIntr1ISR";
mcan1.mcanInt0.interruptHandler = "MCANIntr0ISR";
mcan1.stdFilt0.$name            = "stdFilt0";
mcan1.stdFilt0.sfec             = "MCAN_STDFILTEC_FIFO0";
mcan1.stdFilt0.sfid2            = 4;

/**
 * Pinmux solution for unlocked pins/peripherals. This ensures that minor changes to the automatic solver in a future
 * version of the tool will not impact the pinmux you originally saw.  These lines can be completely deleted in order to
 * re-solve from scratch.
 */
jtag.JTAG.$suggestSolution             = "JTAG";
jtag.JTAG.tdoPin.$suggestSolution      = "GPIO223/TDO";
jtag.JTAG.tdiPin.$suggestSolution      = "GPIO222/TDI";
mcan1.mcan.$suggestSolution            = "MCANB";
mcan1.mcan.mcan_rxPin.$suggestSolution = "GPIO20";
mcan1.mcan.mcan_txPin.$suggestSolution = "GPIO21";
