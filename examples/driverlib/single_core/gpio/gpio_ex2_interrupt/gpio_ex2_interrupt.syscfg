/**
 * @cliArgs --device "F29H85x" --package "256ZEX" --part "F29H85x_256ZEX" --context "CPU1" --product "MCU_SDK_F29H85x@1.02.02.00"
 * @versions {"tool":"1.25.0+4237"}
 */

    
const divider15       = system.clockTree["PLL_REFDIV"];
divider15.divideValue = 1;

const multiplier1         = system.clockTree["PLL_IMULT"];
multiplier1.multiplyValue = 40;

const mux7       = system.clockTree["OSCCLKSRCSEL"];
mux7.inputSelect = "INTOSC2";

/**
 * Import the modules used in this configuration.
 */

const jtag             = scripting.addModule("/driverlib/jtag.js");
const gpio             = scripting.addModule("/driverlib/gpio.js", {}, false);
const gpio1            = gpio.addInstance();
const inputxbar_input  = scripting.addModule("/driverlib/inputxbar_input.js", {}, false);
const inputxbar_input1 = inputxbar_input.addInstance();
const outputxbar       = scripting.addModule("/driverlib/outputxbar.js", {}, false);
const outputxbar1      = outputxbar.addInstance();
const xbar_flags       = scripting.addModule("/driverlib/xbar_flags.js");

/**
 * Write custom configuration values to the imported modules.
 */
gpio1.$name                   = "myGPIO0";
gpio1.useInterrupt            = true;
gpio1.direction               = "GPIO_DIR_MODE_OUT";
gpio1.xint.enableInt          = true;
gpio1.xint.registerInterrupts = true;

inputxbar_input1.$name         = "myINPUTXBARINPUT0";
gpio1.xint.inputxbar           = inputxbar_input1;
inputxbar_input1.inputxbarGpio = "GPIO15";

outputxbar1.$name                            = "myOUTPUTXBAR0";
outputxbar1.sourceSignals                    = ["INPUTXBAR_INPUT4"];
outputxbar1.outputxbar.outputxbarPin.$assign = "GPIO0";

xbar_flags.inputFlagsPeriphConfig.$name  = "driverlib_perConfig0";
xbar_flags.outputFlagsPeriphConfig.$name = "driverlib_perConfig1";

/**
 * Pinmux solution for unlocked pins/peripherals. This ensures that minor changes to the automatic solver in a future
 * version of the tool will not impact the pinmux you originally saw.  These lines can be completely deleted in order to
 * re-solve from scratch.
 */
gpio1.gpioPin.$suggestSolution          = "GPIO15";
outputxbar1.outputxbar.$suggestSolution = "OUTPUTXBAR9";
