/**
 * @cliArgs --device "F29H85x" --package "256ZEX" --part "F29H85x_256ZEX" --context "CPU1" --product "MCU_SDK_F29H85x@1.00.00.00"
 * @versions {"tool":"1.22.0+3877"}
 */

const divider15       = system.clockTree["PLL_REFDIV"];
divider15.divideValue = 1;

const multiplier1         = system.clockTree["PLL_IMULT"];
multiplier1.multiplyValue = 40;

const mux7       = system.clockTree["OSCCLKSRCSEL"];
mux7.inputSelect = "INTOSC2";

/**
 * Import the modules used in this configuration.
 */
const jtag  = scripting.addModule("/driverlib/jtag.js");
const watchdog  = scripting.addModule("/driverlib/watchdog.js", {}, false);
const watchdog1 = watchdog.addInstance();

/**
 * Write custom configuration values to the imported modules.
 */
watchdog1.$name                  = "myWATCHDOG0";
watchdog1.wdMode                 = "SYSCTL_WD_MODE_INTERRUPT";
watchdog1.registerInterrupts     = true;
watchdog1.wdInt.interruptHandler = "watchdogISR";
