/**
 * @cliArgs --board "/boards/LAUNCHXL_F29H85X" --context "CPU1" --product "MCU_SDK_F29H85x@1.02.02.00"
 * @versions {"tool":"1.25.0+4237"}
 */

    
const divider15       = system.clockTree["PLL_REFDIV"];
divider15.divideValue = 1;

const multiplier1         = system.clockTree["PLL_IMULT"];
multiplier1.multiplyValue = 40;

const mux7       = system.clockTree["OSCCLKSRCSEL"];
mux7.inputSelect = "INTOSC2";

/**
 * Import the modules used in this configuration.
 */
const led  = scripting.addModule("/driverlib/board_components/led", {}, false);
const led1 = led.addInstance();
const led2 = led.addInstance();

/**
 * Write custom configuration values to the imported modules.
 */
led1.$name     = "myBoardLED0";
led1.$hardware = system.deviceData.board.components.LED4;

led2.$name     = "myBoardLED1";
led2.$hardware = system.deviceData.board.components.LED5;
