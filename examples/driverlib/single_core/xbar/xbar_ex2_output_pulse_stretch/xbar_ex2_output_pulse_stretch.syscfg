/**
 * @cliArgs --device "F29H85x" --package "256ZEX" --part "F29H85x_256ZEX" --context "CPU1" --product "MCU_SDK_F29H85x@1.02.02.00"
 * @versions {"tool":"1.25.0+4237"}
 */

    
const divider15       = system.clockTree["PLL_REFDIV"];
divider15.divideValue = 1;

const multiplier1         = system.clockTree["PLL_IMULT"];
multiplier1.multiplyValue = 40;

const mux7       = system.clockTree["OSCCLKSRCSEL"];
mux7.inputSelect = "INTOSC2";
/**
 * Import the modules used in this configuration.
 */
const epwm             = scripting.addModule("/driverlib/epwm.js", {}, false);
const epwm1            = epwm.addInstance();
const inputxbar_input  = scripting.addModule("/driverlib/inputxbar_input.js", {}, false);
const inputxbar_input1 = inputxbar_input.addInstance();
const outputxbar       = scripting.addModule("/driverlib/outputxbar.js", {}, false);
const outputxbar1      = outputxbar.addInstance();

/**
 * Write custom configuration values to the imported modules.
 */



epwm1.$name                                                    = "myEPWM0";
epwm1.epwmTimebase_hsClockDiv                                  = "EPWM_HSCLOCK_DIVIDER_1";
epwm1.epwmCounterCompare_cmpA                                  = 4;
epwm1.epwmTimebase_period                                      = 32;
epwm1.epwmActionQualifier_EPWM_AQ_OUTPUT_A_ON_TIMEBASE_ZERO    = "EPWM_AQ_OUTPUT_HIGH";
epwm1.epwmActionQualifier_EPWM_AQ_OUTPUT_A_ON_TIMEBASE_UP_CMPA = "EPWM_AQ_OUTPUT_LOW";
epwm1.epwmActionQualifier_EPWM_AQ_OUTPUT_B_ON_TIMEBASE_ZERO    = "EPWM_AQ_OUTPUT_HIGH";
epwm1.epwmActionQualifier_EPWM_AQ_OUTPUT_B_ON_TIMEBASE_UP_CMPA = "EPWM_AQ_OUTPUT_LOW";
epwm1.epwm.$assign                                             = "EPWM1";
epwm1.periphClock.$name                                        = "driverlib_perClock0";
epwm1.periphConfig.$name                                       = "driverlib_perConfig0";

inputxbar_input1.$name         = "myINPUTXBARINPUT0";
inputxbar_input1.inputxbarGpio = "GPIO0";

outputxbar1.$name                            = "myOUTPUTXBAR0";
outputxbar1.sourceSignals                    = ["INPUTXBAR_INPUT1"];
outputxbar1.selectStretchedPulseSource       = true;
outputxbar1.outputxbar.outputxbarPin.$assign = "GPIO2";



/**
 * Pinmux solution for unlocked pins/peripherals. This ensures that minor changes to the automatic solver in a future
 * version of the tool will not impact the pinmux you originally saw.  These lines can be completely deleted in order to
 * re-solve from scratch.
 */
epwm1.epwm.epwm_aPin.$suggestSolution   = "GPIO0";
epwm1.epwm.epwm_bPin.$suggestSolution   = "GPIO1";
outputxbar1.outputxbar.$suggestSolution = "OUTPUTXBAR1";
