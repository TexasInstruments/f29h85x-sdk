/**
 * @cliArgs --device "F29H85x" --package "256ZEX" --part "F29H85x_256ZEX" --context "CPU1" --product "MCU_SDK_F29H85x@1.00.00.00"
 * @versions {"tool":"1.22.0+3877"}
 */

const divider15       = system.clockTree["PLL_REFDIV"];
divider15.divideValue = 1;

const multiplier1         = system.clockTree["PLL_IMULT"];
multiplier1.multiplyValue = 40;

const mux7       = system.clockTree["OSCCLKSRCSEL"];
mux7.inputSelect = "INTOSC2";

/**
 * Import the modules used in this configuration.
 */
const xclkout  = scripting.addModule("/driverlib/xclkout.js", {}, false);
const xclkout1 = xclkout.addInstance();

/**
 * Write custom configuration values to the imported modules.
 */
xclkout1.$name                      = "myXCLKOUT0";
xclkout1.xclkOutSource              = "SYSCTL_XCLKOUT_SOURCE_INTOSC1";
xclkout1.XCLKOUT.xclkoutPin.$assign = "GPIO73";

/**
 * Pinmux solution for unlocked pins/peripherals. This ensures that minor changes to the automatic solver in a future
 * version of the tool will not impact the pinmux you originally saw.  These lines can be completely deleted in order to
 * re-solve from scratch.
 */
xclkout1.XCLKOUT.$suggestSolution = "OTHER";
