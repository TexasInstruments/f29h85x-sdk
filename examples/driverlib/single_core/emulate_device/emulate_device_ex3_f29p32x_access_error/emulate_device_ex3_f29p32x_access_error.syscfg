/**
 * @cliArgs --device "F29H85x" --part "F29P329SM2QPZS" --package "100PZS" --context "CPU1" --product "MCU_SDK_F29H85x@1.02.02.00"
* @versions {"tool":"1.25.0+4237"}
 */

    
const divider15       = system.clockTree["PLL_REFDIV"];
divider15.divideValue = 1;

const multiplier1         = system.clockTree["PLL_IMULT"];
multiplier1.multiplyValue = 40;

const mux7       = system.clockTree["OSCCLKSRCSEL"];
mux7.inputSelect = "INTOSC2";

/**
 * Import the modules used in this configuration.
 */
const led     = scripting.addModule("/driverlib/board_components/led", {}, false);
const led1    = led.addInstance();
const esm_cpu = scripting.addModule("/driverlib/esm_cpu.js");
const jtag    = scripting.addModule("/driverlib/jtag.js");

/**
 * Write custom configuration values to the imported modules.
 */
led1.$name                  = "myBoardLED0";
led1.gpio.writeInitialValue = true;
led1.gpio.initialValue      = 1;
led1.gpio.gpioPin.$assign   = "GPIO9";

esm_cpu.registerNMI = true;
