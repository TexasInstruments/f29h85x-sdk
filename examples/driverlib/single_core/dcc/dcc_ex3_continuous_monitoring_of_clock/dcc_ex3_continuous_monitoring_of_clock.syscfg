/**
 * @cliArgs --device "F29H85x" --package "256ZEX" --part "F29H85x_256ZEX" --context "CPU1" --product "MCU_SDK_F29H85x@1.02.02.00"
 * @versions {"tool":"1.25.0+4237"}
 */

    
const divider15       = system.clockTree["PLL_REFDIV"];
divider15.divideValue = 1;

const multiplier1         = system.clockTree["PLL_IMULT"];
multiplier1.multiplyValue = 40;

const mux7       = system.clockTree["OSCCLKSRCSEL"];
mux7.inputSelect = "INTOSC2";

/**
 * Import the modules used in this configuration.
 */

const dcc     = scripting.addModule("/driverlib/dcc.js", {}, false);
const dcc1    = dcc.addInstance();
const esm_cpu = scripting.addModule("/driverlib/esm_cpu.js");
const jtag    = scripting.addModule("/driverlib/jtag.js");

/**
 * Write custom configuration values to the imported modules.
 */
dcc1.$name                             = "myDCC0";
dcc1.setCounter0ClkSource              = "DCC_COUNT0SRC_INTOSC1";
dcc1.setCounter1ClkSource              = "DCC_COUNT1SRC_PLL";
dcc1.dccerrtol                         = 1;
dcc1.freqerrtol                        = 3;
dcc1.enableErrorSignal                 = true;
dcc1.periphClock.$name                 = "driverlib_perClock0";
dcc1.periphConfig.$name                = "driverlib_perConfig0";
dcc1.ESMConfig.inCpu1Esm               = true;
dcc1.ESMConfig.esmCPU1.enableInterrupt = true;

esm_cpu.registerInterrupts = true;


/**
 * Pinmux solution for unlocked pins/peripherals. This ensures that minor changes to the automatic solver in a future
 * version of the tool will not impact the pinmux you originally saw.  These lines can be completely deleted in order to
 * re-solve from scratch.
 */
jtag.JTAG.$suggestSolution        = "JTAG";
jtag.JTAG.tdoPin.$suggestSolution = "GPIO223/TDO";
jtag.JTAG.tdiPin.$suggestSolution = "GPIO222/TDI";
