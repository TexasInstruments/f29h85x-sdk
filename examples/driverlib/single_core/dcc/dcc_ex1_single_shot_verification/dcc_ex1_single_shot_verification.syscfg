/**
 * @cliArgs --device "F29H85x" --package "256ZEX" --part "F29H85x_256ZEX" --context "CPU1" --product "MCU_SDK_F29H85x@1.02.02.00"
 * @versions {"tool":"1.25.0+4237"}
 */

    
const divider15       = system.clockTree["PLL_REFDIV"];
divider15.divideValue = 1;

const multiplier1         = system.clockTree["PLL_IMULT"];
multiplier1.multiplyValue = 40;

const mux7       = system.clockTree["OSCCLKSRCSEL"];
mux7.inputSelect = "INTOSC2";

/**
 * Import the modules used in this configuration.
 */
const dcc   = scripting.addModule("/driverlib/dcc.js", {}, false);
const dcc1  = dcc.addInstance();
const jtag  = scripting.addModule("/driverlib/jtag.js");

/**
 * Write custom configuration values to the imported modules.
 */
dcc1.$name                     = "myDCC0";
dcc1.dccerrtol                 = 1;
dcc1.freqerrtol                = 0;
dcc1.enableErrorSignal         = true;
dcc1.enableSingleShotMode      = true;
dcc1.enableDoneSignalInterrupt = true;
dcc1.setCounter0ClkSource      = "DCC_COUNT0SRC_INTOSC2";
dcc1.counter0seed              = 4950;
dcc1.validCounter0seed         = 100;
dcc1.counter1seed              = 100000;
dcc1.periphClock.$name         = "driverlib_perClock0";
dcc1.periphConfig.$name        = "driverlib_perConfig0";
