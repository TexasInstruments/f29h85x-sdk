/**
 * @cliArgs --device "F29H85x" --package "256ZEX" --part "F29H85x_256ZEX" --context "CPU1" --product "MCU_SDK_F29H85x@1.02.02.00"
 * @versions {"tool":"1.25.0+4237"}
 */

    
const divider15       = system.clockTree["PLL_REFDIV"];
divider15.divideValue = 1;

const multiplier1         = system.clockTree["PLL_IMULT"];
multiplier1.multiplyValue = 40;

const mux7       = system.clockTree["OSCCLKSRCSEL"];
mux7.inputSelect = "INTOSC2";

/**
 * Import the modules used in this configuration.
 */
const spi  = scripting.addModule("/driverlib/spi.js", {}, false);
const spi1 = spi.addInstance();
const jtag  = scripting.addModule("/driverlib/jtag.js");

/**
 * Write custom configuration values to the imported modules.
 */
spi1.$name                     = "mySPI0";
spi1.mode                      = "SPI_MODE_CONTROLLER";
spi1.emulationMode             = "SPI_EMULATION_STOP_AFTER_TRANSMIT";
spi1.loopback                  = true;
spi1.bitRate                   = 2000000;
spi1.registerInterrupts        = true;
spi1.txFifo                    = "SPI_FIFO_TX8";
spi1.registerSpiTxInt          = false;
spi1.enabledFIFOInterrupts     = ["SPI_INT_RXFF"];
spi1.rxFifo                    = "SPI_FIFO_RX2";
spi1.spi.$assign               = "SPIA";
spi1.periphClock.$name         = "driverlib_perClock0";
spi1.periphConfig.$name        = "driverlib_perConfig0";
spi1.spiRXInt.interruptHandler = "spiRxFIFOISR";
