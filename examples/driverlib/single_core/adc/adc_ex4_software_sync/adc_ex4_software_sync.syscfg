/**
 * @cliArgs --device "F29H85x" --package "256ZEX" --part "F29H85x_256ZEX" --context "CPU1" --product "MCU_SDK_F29H85x@1.00.00.00"
 * @versions {"tool":"1.22.0+3877"}
 */

const divider15       = system.clockTree["PLL_REFDIV"];
divider15.divideValue = 1;

const multiplier1         = system.clockTree["PLL_IMULT"];
multiplier1.multiplyValue = 40;

const mux7       = system.clockTree["OSCCLKSRCSEL"];
mux7.inputSelect = "INTOSC2";

/**
 * Import the modules used in this configuration.
 */
const adc              = scripting.addModule("/driverlib/adc.js", {}, false);
const adc1             = adc.addInstance();
const adc2             = adc.addInstance();
const asysctl          = scripting.addModule("/driverlib/asysctl.js");
const gpio             = scripting.addModule("/driverlib/gpio.js", {}, false);
const gpio1            = gpio.addInstance();
const inputxbar_input  = scripting.addModule("/driverlib/inputxbar_input.js", {}, false);
const inputxbar_input1 = inputxbar_input.addInstance();

/**
 * Write custom configuration values to the imported modules.
 */
adc1.$name              = "myADC0";
adc1.adcClockPrescaler  = "ADC_CLK_DIV_4_0";
adc1.enabledSOCs        = ["ADC_SOC_NUMBER0","ADC_SOC_NUMBER1"];
adc1.soc0SampleWindow   = 15;
adc1.soc0Trigger        = "ADC_TRIGGER_GPIO";
adc1.soc1Channel        = "ADC_CH_ADCIN1";
adc1.soc1SampleWindow   = 15;
adc1.soc1Trigger        = "ADC_TRIGGER_GPIO";
adc1.interruptPulseMode = "ADC_PULSE_END_OF_CONV";
adc1.enabledInts        = ["ADC_INT_NUMBER1"];
adc1.enableInterrupt1   = true;
adc1.periphClock.$name  = "driverlib_perClock0";
adc1.periphConfig.$name = "driverlib_perConfig0";

adc2.$name                               = "myADC1";
adc2.adcBase                             = "ADCC_BASE";
adc2.adcClockPrescaler                   = "ADC_CLK_DIV_4_0";
adc2.enabledSOCs                         = ["ADC_SOC_NUMBER0","ADC_SOC_NUMBER1"];
adc2.soc0SampleWindow                    = 15;
adc2.soc0Trigger                         = "ADC_TRIGGER_GPIO";
adc2.soc1Channel                         = "ADC_CH_ADCIN1";
adc2.soc1SampleWindow                    = 15;
adc2.soc1Trigger                         = "ADC_TRIGGER_GPIO";
adc2.periphClock.$name                   = "driverlib_perClock1";
adc2.periphClock.pinmuxPeripheralModule  = scripting.forceWrite("");
adc2.periphConfig.$name                  = "driverlib_perConfig1";
adc2.periphConfig.pinmuxPeripheralModule = scripting.forceWrite("");

const analog  = scripting.addModule("/driverlib/analog.js", {}, false);
const analog1 = analog.addInstance({}, false);
analog1.$name = "myANALOGPinMux0";
adc1.analog   = analog1;
adc2.analog   = analog1;

asysctl.analogReferenceAB  = "INTERNAL_3_3_V";
asysctl.analogReferenceCDE = "INTERNAL_3_3_V";

gpio1.$name           = "myGPIO0";
gpio1.direction       = "GPIO_DIR_MODE_OUT";
gpio1.gpioPin.$assign = "GPIO0";

inputxbar_input1.$name          = "myINPUTXBARINPUT0";
inputxbar_input1.inputxbarInput = "XBAR_INPUT5";
inputxbar_input1.inputxbarGpio  = "GPIO0";
