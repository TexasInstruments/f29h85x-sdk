/**
 * @cliArgs --device "F29H85x" --package "256ZEX" --part "F29H85x_256ZEX" --context "CPU1" --product "MCU_SDK_F29H85x@1.00.00.00"
 * @versions {"tool":"1.22.0+3877"}
 */

const divider15       = system.clockTree["PLL_REFDIV"];
divider15.divideValue = 1;

const multiplier1         = system.clockTree["PLL_IMULT"];
multiplier1.multiplyValue = 40;

const mux7       = system.clockTree["OSCCLKSRCSEL"];
mux7.inputSelect = "INTOSC2";

/**
 * Import the modules used in this configuration.
 */
const adc     = scripting.addModule("/driverlib/adc.js", {}, false);
const adc1    = adc.addInstance();
const asysctl = scripting.addModule("/driverlib/asysctl.js");

/**
 * Write custom configuration values to the imported modules.
 */
adc1.$name                    = "myADC0";
adc1.adcClockPrescaler        = "ADC_CLK_DIV_4_0";
adc1.interruptPulseMode       = "ADC_PULSE_END_OF_CONV";
adc1.enabledInts              = ["ADC_INT_NUMBER1","ADC_INT_NUMBER2","ADC_INT_NUMBER3"];
adc1.enableInterrupt1         = true;
adc1.enableInterrupt2         = true;
adc1.enableInterrupt3         = true;
adc1.enableBurstMode          = true;
adc1.burstTrigger             = "ADC_TRIGGER_EPWM1_SOCA";
adc1.burstSize                = 2;
adc1.registerInterrupts       = ["1","2","3"];
adc1.enabledSOCs              = ["ADC_SOC_NUMBER23","ADC_SOC_NUMBER24","ADC_SOC_NUMBER25","ADC_SOC_NUMBER26","ADC_SOC_NUMBER27","ADC_SOC_NUMBER28","ADC_SOC_NUMBER29","ADC_SOC_NUMBER30","ADC_SOC_NUMBER31"];
adc1.soc23SampleWindow        = 15;
adc1.soc24Channel             = "ADC_CH_ADCIN1";
adc1.soc24SampleWindow        = 15;
adc1.soc25Channel             = "ADC_CH_ADCIN2";
adc1.soc25SampleWindow        = 15;
adc1.soc27Channel             = "ADC_CH_ADCIN1";
adc1.soc28Channel             = "ADC_CH_ADCIN3";
adc1.soc29SampleWindow        = 15;
adc1.soc28SampleWindow        = 15;
adc1.soc27SampleWindow        = 15;
adc1.soc26SampleWindow        = 15;
adc1.soc30Channel             = "ADC_CH_ADCIN1";
adc1.soc31Channel             = "ADC_CH_ADCIN4";
adc1.soc31SampleWindow        = 15;
adc1.soc30SampleWindow        = 15;
adc1.interrupt1SOCSource      = "ADC_INT_TRIGGER_EOC25";
adc1.interrupt2SOCSource      = "ADC_INT_TRIGGER_EOC28";
adc1.interrupt3SOCSource      = "ADC_INT_TRIGGER_EOC31";
adc1.socHighPriorityMode      = "ADC_PRI_THRU_SOC22_HIPRI";
adc1.periphClock.$name        = "driverlib_perClock0";
adc1.periphConfig.$name       = "driverlib_perConfig0";
adc1.adcInt1.interruptHandler = "adcABurstISR";
adc1.adcInt2.interruptHandler = "adcABurstISR";
adc1.adcInt3.interruptHandler = "adcABurstISR";
scripting.suppress("SOC23 is configured for Round Robin\\. With burst mode enabled, the  burst mode trigger will override the selected trigger for this SOC", adc1, "soc23Trigger");
scripting.suppress("SOC24 is configured for Round Robin\\. With burst mode enabled, the  burst mode trigger will override the selected trigger for this SOC", adc1, "soc24Trigger");
scripting.suppress("SOC25 is configured for Round Robin\\. With burst mode enabled, the  burst mode trigger will override the selected trigger for this SOC", adc1, "soc25Trigger");
scripting.suppress("SOC26 is configured for Round Robin\\. With burst mode enabled, the  burst mode trigger will override the selected trigger for this SOC", adc1, "soc26Trigger");
scripting.suppress("SOC27 is configured for Round Robin\\. With burst mode enabled, the  burst mode trigger will override the selected trigger for this SOC", adc1, "soc27Trigger");
scripting.suppress("SOC28 is configured for Round Robin\\. With burst mode enabled, the  burst mode trigger will override the selected trigger for this SOC", adc1, "soc28Trigger");
scripting.suppress("SOC29 is configured for Round Robin\\. With burst mode enabled, the  burst mode trigger will override the selected trigger for this SOC", adc1, "soc29Trigger");
scripting.suppress("SOC30 is configured for Round Robin\\. With burst mode enabled, the  burst mode trigger will override the selected trigger for this SOC", adc1, "soc30Trigger");
scripting.suppress("SOC31 is configured for Round Robin\\. With burst mode enabled, the  burst mode trigger will override the selected trigger for this SOC", adc1, "soc31Trigger");

const analog  = scripting.addModule("/driverlib/analog.js", {}, false);
const analog1 = analog.addInstance({}, false);
analog1.$name = "myANALOGPinMux0";
adc1.analog   = analog1;

asysctl.analogReferenceAB = "INTERNAL_3_3_V";
