/**
 * @cliArgs --device "F29H85x" --package "256ZEX" --part "F29H85x_256ZEX" --context "CPU1" --product "MCU_SDK_F29H85x@1.02.02.00"
 * @versions {"tool":"1.25.0+4237"}
 */

    
const divider15       = system.clockTree["PLL_REFDIV"];
divider15.divideValue = 1;

const multiplier1         = system.clockTree["PLL_IMULT"];
multiplier1.multiplyValue = 40;

const mux7       = system.clockTree["OSCCLKSRCSEL"];
mux7.inputSelect = "INTOSC2";

/**
 * Import the modules used in this configuration.
 */
const adc   = scripting.addModule("/driverlib/adc.js", {}, false);
const adc1  = adc.addInstance();
const epwm  = scripting.addModule("/driverlib/epwm.js", {}, false);
const epwm1 = epwm.addInstance();
const gpio  = scripting.addModule("/driverlib/gpio.js", {}, false);
const gpio1 = gpio.addInstance();

/**
 * Write custom configuration values to the imported modules.
 */
adc1.$name               = "myADC0";
adc1.enabledSOCs         = ["ADC_SOC_NUMBER0","ADC_SOC_NUMBER1","ADC_SOC_NUMBER10","ADC_SOC_NUMBER11","ADC_SOC_NUMBER12","ADC_SOC_NUMBER13","ADC_SOC_NUMBER14","ADC_SOC_NUMBER15","ADC_SOC_NUMBER16","ADC_SOC_NUMBER17","ADC_SOC_NUMBER18","ADC_SOC_NUMBER19","ADC_SOC_NUMBER2","ADC_SOC_NUMBER20","ADC_SOC_NUMBER21","ADC_SOC_NUMBER22","ADC_SOC_NUMBER23","ADC_SOC_NUMBER24","ADC_SOC_NUMBER25","ADC_SOC_NUMBER26","ADC_SOC_NUMBER27","ADC_SOC_NUMBER28","ADC_SOC_NUMBER29","ADC_SOC_NUMBER3","ADC_SOC_NUMBER30","ADC_SOC_NUMBER31","ADC_SOC_NUMBER4","ADC_SOC_NUMBER5","ADC_SOC_NUMBER6","ADC_SOC_NUMBER7","ADC_SOC_NUMBER8","ADC_SOC_NUMBER9"];
adc1.soc0Channel         = "ADC_CH_ADCIN2";
adc1.soc0SampleWindow    = 15;
adc1.soc1Channel         = "ADC_CH_ADCIN2";
adc1.soc1SampleWindow    = 15;
adc1.soc2Channel         = "ADC_CH_ADCIN2";
adc1.soc2SampleWindow    = 15;
adc1.soc3Channel         = "ADC_CH_ADCIN2";
adc1.soc3SampleWindow    = 15;
adc1.soc4SampleWindow    = 15;
adc1.soc4Channel         = "ADC_CH_ADCIN2";
adc1.soc5Channel         = "ADC_CH_ADCIN2";
adc1.soc5SampleWindow    = 15;
adc1.soc6Channel         = "ADC_CH_ADCIN2";
adc1.soc6SampleWindow    = 15;
adc1.soc7Channel         = "ADC_CH_ADCIN2";
adc1.soc7SampleWindow    = 15;
adc1.soc8SampleWindow    = 15;
adc1.soc8Channel         = "ADC_CH_ADCIN2";
adc1.soc9Channel         = "ADC_CH_ADCIN2";
adc1.soc9SampleWindow    = 15;
adc1.soc10Channel        = "ADC_CH_ADCIN2";
adc1.soc10SampleWindow   = 15;
adc1.soc11Channel        = "ADC_CH_ADCIN2";
adc1.soc11SampleWindow   = 15;
adc1.soc12Channel        = "ADC_CH_ADCIN2";
adc1.soc12SampleWindow   = 15;
adc1.soc13Channel        = "ADC_CH_ADCIN2";
adc1.soc13SampleWindow   = 15;
adc1.soc14Channel        = "ADC_CH_ADCIN2";
adc1.soc14SampleWindow   = 15;
adc1.soc15Channel        = "ADC_CH_ADCIN2";
adc1.soc15SampleWindow   = 15;
adc1.soc16Channel        = "ADC_CH_ADCIN2";
adc1.soc16SampleWindow   = 15;
adc1.soc17Channel        = "ADC_CH_ADCIN2";
adc1.soc17SampleWindow   = 15;
adc1.soc18Channel        = "ADC_CH_ADCIN2";
adc1.soc18SampleWindow   = 15;
adc1.soc19Channel        = "ADC_CH_ADCIN2";
adc1.soc19SampleWindow   = 15;
adc1.soc20Channel        = "ADC_CH_ADCIN2";
adc1.soc20SampleWindow   = 15;
adc1.soc21Channel        = "ADC_CH_ADCIN2";
adc1.soc21SampleWindow   = 15;
adc1.soc22Channel        = "ADC_CH_ADCIN2";
adc1.soc22SampleWindow   = 15;
adc1.soc23Channel        = "ADC_CH_ADCIN2";
adc1.soc23SampleWindow   = 15;
adc1.soc24Channel        = "ADC_CH_ADCIN2";
adc1.soc24SampleWindow   = 15;
adc1.soc25Channel        = "ADC_CH_ADCIN2";
adc1.soc25SampleWindow   = 15;
adc1.soc26Channel        = "ADC_CH_ADCIN2";
adc1.soc26SampleWindow   = 15;
adc1.soc27Channel        = "ADC_CH_ADCIN2";
adc1.soc27SampleWindow   = 15;
adc1.soc28Channel        = "ADC_CH_ADCIN2";
adc1.soc28SampleWindow   = 15;
adc1.soc29Channel        = "ADC_CH_ADCIN2";
adc1.soc29SampleWindow   = 15;
adc1.soc30Channel        = "ADC_CH_ADCIN2";
adc1.soc30SampleWindow   = 15;
adc1.soc31Channel        = "ADC_CH_ADCIN2";
adc1.soc31SampleWindow   = 15;
adc1.interruptPulseMode  = "ADC_PULSE_END_OF_CONV";
adc1.enabledInts         = ["ADC_INT_NUMBER1"];
adc1.interrupt1SOCSource = "ADC_INT_TRIGGER_EOC31";
adc1.enableBurstMode     = true;
adc1.burstTrigger        = "ADC_TRIGGER_EPWM1_SOCA";
adc1.registerInterrupts  = ["1"];
adc1.enableInterrupt1    = true;
adc1.periphClock.$name   = "driverlib_perClock0";
adc1.periphConfig.$name  = "driverlib_perConfig0";
scripting.suppress("SOC0 is configured for Round Robin\\. With burst mode enabled, the  burst mode trigger will override the selected trigger for this SOC", adc1, "soc0Trigger");
scripting.suppress("SOC1 is configured for Round Robin\\. With burst mode enabled, the  burst mode trigger will override the selected trigger for this SOC", adc1, "soc1Trigger");
scripting.suppress("SOC2 is configured for Round Robin\\. With burst mode enabled, the  burst mode trigger will override the selected trigger for this SOC", adc1, "soc2Trigger");
scripting.suppress("SOC3 is configured for Round Robin\\. With burst mode enabled, the  burst mode trigger will override the selected trigger for this SOC", adc1, "soc3Trigger");
scripting.suppress("SOC4 is configured for Round Robin\\. With burst mode enabled, the  burst mode trigger will override the selected trigger for this SOC", adc1, "soc4Trigger");
scripting.suppress("SOC5 is configured for Round Robin\\. With burst mode enabled, the  burst mode trigger will override the selected trigger for this SOC", adc1, "soc5Trigger");
scripting.suppress("SOC6 is configured for Round Robin\\. With burst mode enabled, the  burst mode trigger will override the selected trigger for this SOC", adc1, "soc6Trigger");
scripting.suppress("SOC7 is configured for Round Robin\\. With burst mode enabled, the  burst mode trigger will override the selected trigger for this SOC", adc1, "soc7Trigger");
scripting.suppress("SOC8 is configured for Round Robin\\. With burst mode enabled, the  burst mode trigger will override the selected trigger for this SOC", adc1, "soc8Trigger");
scripting.suppress("SOC9 is configured for Round Robin\\. With burst mode enabled, the  burst mode trigger will override the selected trigger for this SOC", adc1, "soc9Trigger");
scripting.suppress("SOC10 is configured for Round Robin\\. With burst mode enabled, the  burst mode trigger will override the selected trigger for this SOC", adc1, "soc10Trigger");
scripting.suppress("SOC11 is configured for Round Robin\\. With burst mode enabled, the  burst mode trigger will override the selected trigger for this SOC", adc1, "soc11Trigger");
scripting.suppress("SOC12 is configured for Round Robin\\. With burst mode enabled, the  burst mode trigger will override the selected trigger for this SOC", adc1, "soc12Trigger");
scripting.suppress("SOC13 is configured for Round Robin\\. With burst mode enabled, the  burst mode trigger will override the selected trigger for this SOC", adc1, "soc13Trigger");
scripting.suppress("SOC14 is configured for Round Robin\\. With burst mode enabled, the  burst mode trigger will override the selected trigger for this SOC", adc1, "soc14Trigger");
scripting.suppress("SOC15 is configured for Round Robin\\. With burst mode enabled, the  burst mode trigger will override the selected trigger for this SOC", adc1, "soc15Trigger");
scripting.suppress("SOC16 is configured for Round Robin\\. With burst mode enabled, the  burst mode trigger will override the selected trigger for this SOC", adc1, "soc16Trigger");
scripting.suppress("SOC17 is configured for Round Robin\\. With burst mode enabled, the  burst mode trigger will override the selected trigger for this SOC", adc1, "soc17Trigger");
scripting.suppress("SOC18 is configured for Round Robin\\. With burst mode enabled, the  burst mode trigger will override the selected trigger for this SOC", adc1, "soc18Trigger");
scripting.suppress("SOC19 is configured for Round Robin\\. With burst mode enabled, the  burst mode trigger will override the selected trigger for this SOC", adc1, "soc19Trigger");
scripting.suppress("SOC20 is configured for Round Robin\\. With burst mode enabled, the  burst mode trigger will override the selected trigger for this SOC", adc1, "soc20Trigger");
scripting.suppress("SOC21 is configured for Round Robin\\. With burst mode enabled, the  burst mode trigger will override the selected trigger for this SOC", adc1, "soc21Trigger");
scripting.suppress("SOC22 is configured for Round Robin\\. With burst mode enabled, the  burst mode trigger will override the selected trigger for this SOC", adc1, "soc22Trigger");
scripting.suppress("SOC23 is configured for Round Robin\\. With burst mode enabled, the  burst mode trigger will override the selected trigger for this SOC", adc1, "soc23Trigger");
scripting.suppress("SOC24 is configured for Round Robin\\. With burst mode enabled, the  burst mode trigger will override the selected trigger for this SOC", adc1, "soc24Trigger");
scripting.suppress("SOC25 is configured for Round Robin\\. With burst mode enabled, the  burst mode trigger will override the selected trigger for this SOC", adc1, "soc25Trigger");
scripting.suppress("SOC26 is configured for Round Robin\\. With burst mode enabled, the  burst mode trigger will override the selected trigger for this SOC", adc1, "soc26Trigger");
scripting.suppress("SOC27 is configured for Round Robin\\. With burst mode enabled, the  burst mode trigger will override the selected trigger for this SOC", adc1, "soc27Trigger");
scripting.suppress("SOC28 is configured for Round Robin\\. With burst mode enabled, the  burst mode trigger will override the selected trigger for this SOC", adc1, "soc28Trigger");
scripting.suppress("SOC29 is configured for Round Robin\\. With burst mode enabled, the  burst mode trigger will override the selected trigger for this SOC", adc1, "soc29Trigger");
scripting.suppress("SOC30 is configured for Round Robin\\. With burst mode enabled, the  burst mode trigger will override the selected trigger for this SOC", adc1, "soc30Trigger");
scripting.suppress("SOC31 is configured for Round Robin\\. With burst mode enabled, the  burst mode trigger will override the selected trigger for this SOC", adc1, "soc31Trigger");

const analog  = scripting.addModule("/driverlib/analog.js", {}, false);
const analog1 = analog.addInstance({}, false);
analog1.$name = "myANALOGPinMux0";
adc1.analog   = analog1;

epwm1.$name                                                    = "myEPWM0";
epwm1.epwmTimebase_hsClockDiv                                  = "EPWM_HSCLOCK_DIVIDER_1";
epwm1.epwmTimebase_period                                      = 910;
epwm1.epwmCounterCompare_cmpA                                  = 909;
epwm1.epwmActionQualifier_EPWM_AQ_OUTPUT_A_ON_TIMEBASE_ZERO    = "EPWM_AQ_OUTPUT_HIGH";
epwm1.epwmActionQualifier_EPWM_AQ_OUTPUT_A_ON_TIMEBASE_UP_CMPA = "EPWM_AQ_OUTPUT_LOW";
epwm1.epwmEventTrigger_EPWM_SOC_A_triggerEnable                = true;
epwm1.epwmEventTrigger_EPWM_SOC_A_triggerSource                = "EPWM_SOC_TBCTR_U_CMPA";
epwm1.epwmEventTrigger_EPWM_SOC_A_triggerEventPrescalar        = "1";
epwm1.periphClock.$name                                        = "driverlib_perClock1";
epwm1.periphConfig.$name                                       = "driverlib_perConfig1";

gpio1.$name           = "myGPIO0";
gpio1.direction       = "GPIO_DIR_MODE_OUT";
gpio1.gpioPin.$assign = "GPIO0";
