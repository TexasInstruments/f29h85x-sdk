/**
 * @cliArgs --device "F29H85x" --package "256ZEX" --part "F29H85x_256ZEX" --context "CPU1" --product "MCU_SDK_F29H85x@1.00.00.00"
 * @versions {"tool":"1.22.0+3877"}
 */

const divider15       = system.clockTree["PLL_REFDIV"];
divider15.divideValue = 1;

const multiplier1         = system.clockTree["PLL_IMULT"];
multiplier1.multiplyValue = 40;

const mux7       = system.clockTree["OSCCLKSRCSEL"];
mux7.inputSelect = "INTOSC2";

/**
 * Import the modules used in this configuration.
 */
const adc     = scripting.addModule("/driverlib/adc.js", {}, false);
const adc1    = adc.addInstance();
const asysctl = scripting.addModule("/driverlib/asysctl.js");

/**
 * Write custom configuration values to the imported modules.
 */
adc1.$name                    = "myADC0";
adc1.adcClockPrescaler        = "ADC_CLK_DIV_4_0";
adc1.interruptPulseMode       = "ADC_PULSE_END_OF_CONV";
adc1.enabledSOCs              = ["ADC_SOC_NUMBER0","ADC_SOC_NUMBER1","ADC_SOC_NUMBER2","ADC_SOC_NUMBER3","ADC_SOC_NUMBER4","ADC_SOC_NUMBER5"];
adc1.soc0Trigger              = "ADC_TRIGGER_EPWM1_SOCA";
adc1.soc1Trigger              = "ADC_TRIGGER_EPWM1_SOCA";
adc1.soc2Trigger              = "ADC_TRIGGER_EPWM1_SOCA";
adc1.soc3Trigger              = "ADC_TRIGGER_EPWM1_SOCA";
adc1.soc4Trigger              = "ADC_TRIGGER_EPWM1_SOCA";
adc1.soc5Trigger              = "ADC_TRIGGER_EPWM1_SOCA";
adc1.soc1Channel              = "ADC_CH_ADCIN1";
adc1.soc2Channel              = "ADC_CH_ADCIN2";
adc1.soc3Channel              = "ADC_CH_ADCIN2";
adc1.soc4Channel              = "ADC_CH_ADCIN2";
adc1.soc5Channel              = "ADC_CH_ADCIN2";
adc1.soc0SampleWindow         = 15;
adc1.soc1SampleWindow         = 15;
adc1.soc2SampleWindow         = 15;
adc1.soc3SampleWindow         = 15;
adc1.soc4SampleWindow         = 15;
adc1.soc5SampleWindow         = 15;
adc1.enabledInts              = ["ADC_INT_NUMBER1"];
adc1.enableInterrupt1         = true;
adc1.interrupt1SOCSource      = "ADC_INT_TRIGGER_EOC5";
adc1.registerInterrupts       = ["1"];
adc1.adcInt1.enableInterrupt  = true;
adc1.adcInt1.interruptHandler = "adcA1ISR";

const analog  = scripting.addModule("/driverlib/analog.js", {}, false);
const analog1 = analog.addInstance({}, false);
analog1.$name = "myANALOGPinMux0";
adc1.analog   = analog1;

asysctl.analogReferenceAB = "INTERNAL_3_3_V";
