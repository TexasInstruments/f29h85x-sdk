/**
 * @cliArgs --device "F29H85x" --package "256ZEX" --part "F29H85x_256ZEX" --context "CPU1" --product "MCU_SDK_F29H85x@1.02.02.00"
 * @versions {"tool":"1.25.0+4237"}
 */

    
const divider15       = system.clockTree["PLL_REFDIV"];
divider15.divideValue = 1;

const multiplier1         = system.clockTree["PLL_IMULT"];
multiplier1.multiplyValue = 40;

const mux7       = system.clockTree["OSCCLKSRCSEL"];
mux7.inputSelect = "INTOSC2";

/**
 * Import the modules used in this configuration.
 */
const adc  = scripting.addModule("/driverlib/adc.js", {}, false);
const adc1 = adc.addInstance();
const adc2 = adc.addInstance();
const asysctl = scripting.addModule("/driverlib/asysctl.js");

/**
 * Write custom configuration values to the imported modules.
 */
adc1.$name                 = "myADC0";
adc1.adcClockPrescaler     = "ADC_CLK_DIV_4_0";
adc1.enabledSOCs           = ["ADC_SOC_NUMBER0","ADC_SOC_NUMBER1"];
adc1.soc0SampleWindow      = 15;
adc1.soc1SampleWindow      = 15;
adc1.enabledPPBs           = ["ADC_PPB_NUMBER1"];
adc1.ppb1CalibrationOffset = 100;
adc1.ppb1SOCNumber         = "ADC_SOC_NUMBER1";
adc1.enabledInts           = ["ADC_INT_NUMBER1"];
adc1.interrupt1SOCSource   = "ADC_INT_TRIGGER_EOC1";
adc1.enableInterrupt1      = true;
adc1.periphClock.$name     = "driverlib_perClock0";
adc1.periphConfig.$name    = "driverlib_perConfig0";

adc2.$name                               = "myADC1";
adc2.adcBase                             = "ADCC_BASE";
adc2.adcClockPrescaler                   = "ADC_CLK_DIV_4_0";
adc2.enabledSOCs                         = ["ADC_SOC_NUMBER0","ADC_SOC_NUMBER1"];
adc2.soc0SampleWindow                    = 15;
adc2.soc1SampleWindow                    = 15;
adc2.enabledInts                         = ["ADC_INT_NUMBER1"];
adc2.interrupt1SOCSource                 = "ADC_INT_TRIGGER_EOC1";
adc2.enableInterrupt1                    = true;
adc2.enabledPPBs                         = ["ADC_PPB_NUMBER1"];
adc2.ppb1SOCNumber                       = "ADC_SOC_NUMBER1";
adc2.ppb1CalibrationOffset               = -100;
adc2.periphClock.$name                   = "driverlib_perClock1";
adc2.periphClock.pinmuxPeripheralModule  = scripting.forceWrite("");
adc2.periphConfig.$name                  = "driverlib_perConfig1";
adc2.periphConfig.pinmuxPeripheralModule = scripting.forceWrite("");

const analog  = scripting.addModule("/driverlib/analog.js", {}, false);
const analog1 = analog.addInstance({}, false);
analog1.$name = "myANALOGPinMux0";
adc1.analog   = analog1;
adc2.analog   = analog1;

asysctl.analogReferenceAB  = "INTERNAL_3_3_V";
asysctl.analogReferenceCDE = "INTERNAL_3_3_V";
