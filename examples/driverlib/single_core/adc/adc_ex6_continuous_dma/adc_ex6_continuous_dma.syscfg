/**
 * @cliArgs --device "F29H85x" --package "256ZEX" --part "F29H85x_256ZEX" --context "CPU1" --product "MCU_SDK_F29H85x@1.02.02.00"
 * @versions {"tool":"1.25.0+4237"}
 */

    
const divider15       = system.clockTree["PLL_REFDIV"];
divider15.divideValue = 1;

const multiplier1         = system.clockTree["PLL_IMULT"];
multiplier1.multiplyValue = 40;

const mux7       = system.clockTree["OSCCLKSRCSEL"];
mux7.inputSelect = "INTOSC2";

/**
 * Import the modules used in this configuration.
 */
const adc  = scripting.addModule("/driverlib/adc.js", {}, false);
const adc1 = adc.addInstance();
const adc2 = adc.addInstance();
const asysctl = scripting.addModule("/driverlib/asysctl.js");

/**
 * Write custom configuration values to the imported modules.
 */
adc1.$name                          = "myADC0";
adc1.registerInterrupts             = ["1"];
adc1.adcClockPrescaler              = "ADC_CLK_DIV_4_0";
adc1.interruptPulseMode             = "ADC_PULSE_END_OF_CONV";
adc1.enabledSOCs                    = ["ADC_SOC_NUMBER0","ADC_SOC_NUMBER1","ADC_SOC_NUMBER10","ADC_SOC_NUMBER11","ADC_SOC_NUMBER12","ADC_SOC_NUMBER13","ADC_SOC_NUMBER14","ADC_SOC_NUMBER15","ADC_SOC_NUMBER16","ADC_SOC_NUMBER17","ADC_SOC_NUMBER18","ADC_SOC_NUMBER19","ADC_SOC_NUMBER2","ADC_SOC_NUMBER20","ADC_SOC_NUMBER21","ADC_SOC_NUMBER22","ADC_SOC_NUMBER23","ADC_SOC_NUMBER24","ADC_SOC_NUMBER25","ADC_SOC_NUMBER26","ADC_SOC_NUMBER27","ADC_SOC_NUMBER28","ADC_SOC_NUMBER29","ADC_SOC_NUMBER3","ADC_SOC_NUMBER30","ADC_SOC_NUMBER31","ADC_SOC_NUMBER4","ADC_SOC_NUMBER5","ADC_SOC_NUMBER6","ADC_SOC_NUMBER7","ADC_SOC_NUMBER8","ADC_SOC_NUMBER9"];
adc1.soc0SampleWindow               = 15;
adc1.soc1SampleWindow               = 15;
adc1.soc2SampleWindow               = 15;
adc1.soc3SampleWindow               = 15;
adc1.soc4SampleWindow               = 15;
adc1.soc5SampleWindow               = 15;
adc1.soc6SampleWindow               = 15;
adc1.soc7SampleWindow               = 15;
adc1.soc8SampleWindow               = 15;
adc1.soc9SampleWindow               = 15;
adc1.soc10SampleWindow              = 15;
adc1.soc11SampleWindow              = 15;
adc1.soc12SampleWindow              = 15;
adc1.soc13SampleWindow              = 15;
adc1.soc14SampleWindow              = 15;
adc1.soc15SampleWindow              = 15;
adc1.soc16SampleWindow              = 15;
adc1.soc17SampleWindow              = 15;
adc1.soc18SampleWindow              = 15;
adc1.soc19SampleWindow              = 15;
adc1.soc20SampleWindow              = 15;
adc1.soc21SampleWindow              = 15;
adc1.soc22SampleWindow              = 15;
adc1.soc23SampleWindow              = 15;
adc1.soc24SampleWindow              = 15;
adc1.soc25SampleWindow              = 15;
adc1.soc26SampleWindow              = 15;
adc1.soc27SampleWindow              = 15;
adc1.soc28SampleWindow              = 15;
adc1.soc29SampleWindow              = 15;
adc1.soc30SampleWindow              = 15;
adc1.soc31SampleWindow              = 15;
adc1.soc0Channel                    = "ADC_CH_ADCIN3";
adc1.soc1Channel                    = "ADC_CH_ADCIN3";
adc1.soc2Channel                    = "ADC_CH_ADCIN3";
adc1.soc3Channel                    = "ADC_CH_ADCIN3";
adc1.soc4Channel                    = "ADC_CH_ADCIN3";
adc1.soc5Channel                    = "ADC_CH_ADCIN3";
adc1.soc6Channel                    = "ADC_CH_ADCIN3";
adc1.soc7Channel                    = "ADC_CH_ADCIN3";
adc1.soc8Channel                    = "ADC_CH_ADCIN3";
adc1.soc9Channel                    = "ADC_CH_ADCIN3";
adc1.soc10Channel                   = "ADC_CH_ADCIN3";
adc1.soc11Channel                   = "ADC_CH_ADCIN3";
adc1.soc12Channel                   = "ADC_CH_ADCIN3";
adc1.soc13Channel                   = "ADC_CH_ADCIN3";
adc1.soc14Channel                   = "ADC_CH_ADCIN3";
adc1.soc15Channel                   = "ADC_CH_ADCIN3";
adc1.soc16Channel                   = "ADC_CH_ADCIN3";
adc1.soc17Channel                   = "ADC_CH_ADCIN3";
adc1.soc18Channel                    = "ADC_CH_ADCIN3";
adc1.soc19Channel                   = "ADC_CH_ADCIN3";
adc1.soc20Channel                   = "ADC_CH_ADCIN3";
adc1.soc21Channel                   = "ADC_CH_ADCIN3";
adc1.soc22Channel                   = "ADC_CH_ADCIN3";
adc1.soc23Channel                   = "ADC_CH_ADCIN3";
adc1.soc24Channel                   = "ADC_CH_ADCIN3";
adc1.soc25Channel                   = "ADC_CH_ADCIN3";
adc1.soc26Channel                   = "ADC_CH_ADCIN3";
adc1.soc27Channel                   = "ADC_CH_ADCIN3";
adc1.soc28Channel                   = "ADC_CH_ADCIN3";
adc1.soc29Channel                   = "ADC_CH_ADCIN3";
adc1.soc30Channel                   = "ADC_CH_ADCIN3";
adc1.soc31Channel                   = "ADC_CH_ADCIN3";
adc1.soc0Trigger                    = "ADC_TRIGGER_EPWM2_SOCA";
adc1.soc0InterruptTrigger           = "ADC_INT_SOC_TRIGGER_ADCINT1";
adc1.soc1InterruptTrigger           = "ADC_INT_SOC_TRIGGER_ADCINT1";
adc1.soc2InterruptTrigger           = "ADC_INT_SOC_TRIGGER_ADCINT1";
adc1.soc3InterruptTrigger           = "ADC_INT_SOC_TRIGGER_ADCINT1";
adc1.soc4InterruptTrigger           = "ADC_INT_SOC_TRIGGER_ADCINT1";
adc1.soc5InterruptTrigger           = "ADC_INT_SOC_TRIGGER_ADCINT1";
adc1.soc6InterruptTrigger           = "ADC_INT_SOC_TRIGGER_ADCINT1";
adc1.soc7InterruptTrigger           = "ADC_INT_SOC_TRIGGER_ADCINT1";
adc1.soc8InterruptTrigger           = "ADC_INT_SOC_TRIGGER_ADCINT1";
adc1.soc9InterruptTrigger           = "ADC_INT_SOC_TRIGGER_ADCINT1";
adc1.soc10InterruptTrigger          = "ADC_INT_SOC_TRIGGER_ADCINT1";
adc1.soc11InterruptTrigger          = "ADC_INT_SOC_TRIGGER_ADCINT1";
adc1.soc12InterruptTrigger          = "ADC_INT_SOC_TRIGGER_ADCINT1";
adc1.soc13InterruptTrigger          = "ADC_INT_SOC_TRIGGER_ADCINT1";
adc1.soc14InterruptTrigger          = "ADC_INT_SOC_TRIGGER_ADCINT1";
adc1.soc15InterruptTrigger          = "ADC_INT_SOC_TRIGGER_ADCINT1";
adc1.soc16InterruptTrigger          = "ADC_INT_SOC_TRIGGER_ADCINT1";
adc1.soc17InterruptTrigger          = "ADC_INT_SOC_TRIGGER_ADCINT1";
adc1.soc18InterruptTrigger          = "ADC_INT_SOC_TRIGGER_ADCINT1";
adc1.soc19InterruptTrigger          = "ADC_INT_SOC_TRIGGER_ADCINT1";
adc1.soc20InterruptTrigger          = "ADC_INT_SOC_TRIGGER_ADCINT1";
adc1.soc21InterruptTrigger          = "ADC_INT_SOC_TRIGGER_ADCINT1";
adc1.soc22InterruptTrigger          = "ADC_INT_SOC_TRIGGER_ADCINT1";
adc1.soc23InterruptTrigger          = "ADC_INT_SOC_TRIGGER_ADCINT1";
adc1.soc24InterruptTrigger          = "ADC_INT_SOC_TRIGGER_ADCINT1";
adc1.soc25InterruptTrigger          = "ADC_INT_SOC_TRIGGER_ADCINT1";
adc1.soc26InterruptTrigger          = "ADC_INT_SOC_TRIGGER_ADCINT1";
adc1.soc27InterruptTrigger          = "ADC_INT_SOC_TRIGGER_ADCINT1";
adc1.soc28InterruptTrigger          = "ADC_INT_SOC_TRIGGER_ADCINT1";
adc1.soc29InterruptTrigger          = "ADC_INT_SOC_TRIGGER_ADCINT1";
adc1.soc30InterruptTrigger          = "ADC_INT_SOC_TRIGGER_ADCINT1";
adc1.soc31InterruptTrigger          = "ADC_INT_SOC_TRIGGER_ADCINT1";
adc1.enabledInts                    = ["ADC_INT_NUMBER1","ADC_INT_NUMBER2","ADC_INT_NUMBER3","ADC_INT_NUMBER4"];
adc1.enableInterrupt1               = true;
adc1.enableInterrupt2               = true;
adc1.enableInterrupt1ContinuousMode = true;
adc1.enableInterrupt2ContinuousMode = true;
adc1.interrupt2SOCSource            = "ADC_INT_TRIGGER_EOC31";
adc1.adcInt1.enableInterrupt        = true;
adc1.adcInt1.interruptHandler       = "adcA1ISR";

adc2.$name                          = "myADC1";
adc2.adcBase                        = "ADCC_BASE";
adc2.adcClockPrescaler              = "ADC_CLK_DIV_4_0";
adc2.interruptPulseMode             = "ADC_PULSE_END_OF_CONV";
adc2.enabledSOCs                    = ["ADC_SOC_NUMBER0","ADC_SOC_NUMBER1","ADC_SOC_NUMBER10","ADC_SOC_NUMBER11","ADC_SOC_NUMBER12","ADC_SOC_NUMBER13","ADC_SOC_NUMBER14","ADC_SOC_NUMBER15","ADC_SOC_NUMBER16","ADC_SOC_NUMBER17","ADC_SOC_NUMBER18","ADC_SOC_NUMBER19","ADC_SOC_NUMBER2","ADC_SOC_NUMBER20","ADC_SOC_NUMBER21","ADC_SOC_NUMBER22","ADC_SOC_NUMBER23","ADC_SOC_NUMBER24","ADC_SOC_NUMBER25","ADC_SOC_NUMBER26","ADC_SOC_NUMBER27","ADC_SOC_NUMBER28","ADC_SOC_NUMBER29","ADC_SOC_NUMBER3","ADC_SOC_NUMBER30","ADC_SOC_NUMBER31","ADC_SOC_NUMBER4","ADC_SOC_NUMBER5","ADC_SOC_NUMBER6","ADC_SOC_NUMBER7","ADC_SOC_NUMBER8","ADC_SOC_NUMBER9"];
adc2.soc0SampleWindow               = 15;
adc2.soc1SampleWindow               = 15;
adc2.soc2SampleWindow               = 15;
adc2.soc3SampleWindow               = 15;
adc2.soc4SampleWindow               = 15;
adc2.soc5SampleWindow               = 15;
adc2.soc6SampleWindow               = 15;
adc2.soc7SampleWindow               = 15;
adc2.soc8SampleWindow               = 15;
adc2.soc9SampleWindow               = 15;
adc2.soc10SampleWindow              = 15;
adc2.soc11SampleWindow              = 15;
adc2.soc12SampleWindow              = 15;
adc2.soc13SampleWindow              = 15;
adc2.soc14SampleWindow              = 15;
adc2.soc15SampleWindow              = 15;
adc2.soc16SampleWindow              = 15;
adc2.soc17SampleWindow              = 15;
adc2.soc18SampleWindow              = 15;
adc2.soc19SampleWindow              = 15;
adc2.soc20SampleWindow              = 15;
adc2.soc21SampleWindow              = 15;
adc2.soc22SampleWindow              = 15;
adc2.soc23SampleWindow              = 15;
adc2.soc24SampleWindow              = 15;
adc2.soc25SampleWindow              = 15;
adc2.soc26SampleWindow              = 15;
adc2.soc27SampleWindow              = 15;
adc2.soc28SampleWindow              = 15;
adc2.soc29SampleWindow              = 15;
adc2.soc30SampleWindow              = 15;
adc2.soc31SampleWindow              = 15;
adc2.soc0Channel                    = "ADC_CH_ADCIN3";
adc2.soc1Channel                    = "ADC_CH_ADCIN3";
adc2.soc2Channel                    = "ADC_CH_ADCIN3";
adc2.soc3Channel                    = "ADC_CH_ADCIN3";
adc2.soc4Channel                    = "ADC_CH_ADCIN3";
adc2.soc5Channel                    = "ADC_CH_ADCIN3";
adc2.soc6Channel                    = "ADC_CH_ADCIN3";
adc2.soc7Channel                    = "ADC_CH_ADCIN3";
adc2.soc8Channel                    = "ADC_CH_ADCIN3";
adc2.soc9Channel                    = "ADC_CH_ADCIN3";
adc2.soc10Channel                   = "ADC_CH_ADCIN3";
adc2.soc11Channel                   = "ADC_CH_ADCIN3";
adc2.soc12Channel                   = "ADC_CH_ADCIN3";
adc2.soc13Channel                   = "ADC_CH_ADCIN3";
adc2.soc14Channel                   = "ADC_CH_ADCIN3";
adc2.soc15Channel                   = "ADC_CH_ADCIN3";
adc1.soc16Channel                   = "ADC_CH_ADCIN3";
adc2.soc17Channel                   = "ADC_CH_ADCIN3";
adc2.soc18Channel                    = "ADC_CH_ADCIN3";
adc2.soc19Channel                   = "ADC_CH_ADCIN3";
adc2.soc20Channel                   = "ADC_CH_ADCIN3";
adc2.soc21Channel                   = "ADC_CH_ADCIN3";
adc2.soc22Channel                   = "ADC_CH_ADCIN3";
adc2.soc23Channel                   = "ADC_CH_ADCIN3";
adc2.soc24Channel                   = "ADC_CH_ADCIN3";
adc2.soc25Channel                   = "ADC_CH_ADCIN3";
adc2.soc26Channel                   = "ADC_CH_ADCIN3";
adc2.soc27Channel                   = "ADC_CH_ADCIN3";
adc2.soc28Channel                   = "ADC_CH_ADCIN3";
adc2.soc29Channel                   = "ADC_CH_ADCIN3";
adc2.soc30Channel                   = "ADC_CH_ADCIN3";
adc2.soc31Channel                   = "ADC_CH_ADCIN3";
adc2.soc0Trigger                    = "ADC_TRIGGER_EPWM2_SOCA";
adc2.soc0InterruptTrigger           = "ADC_INT_SOC_TRIGGER_ADCINT1";
adc2.soc1InterruptTrigger           = "ADC_INT_SOC_TRIGGER_ADCINT1";
adc2.soc2InterruptTrigger           = "ADC_INT_SOC_TRIGGER_ADCINT1";
adc2.soc3InterruptTrigger           = "ADC_INT_SOC_TRIGGER_ADCINT1";
adc2.soc4InterruptTrigger           = "ADC_INT_SOC_TRIGGER_ADCINT1";
adc2.soc5InterruptTrigger           = "ADC_INT_SOC_TRIGGER_ADCINT1";
adc2.soc6InterruptTrigger           = "ADC_INT_SOC_TRIGGER_ADCINT1";
adc2.soc7InterruptTrigger           = "ADC_INT_SOC_TRIGGER_ADCINT1";
adc2.soc8InterruptTrigger           = "ADC_INT_SOC_TRIGGER_ADCINT1";
adc2.soc9InterruptTrigger           = "ADC_INT_SOC_TRIGGER_ADCINT1";
adc2.soc10InterruptTrigger          = "ADC_INT_SOC_TRIGGER_ADCINT1";
adc2.soc11InterruptTrigger          = "ADC_INT_SOC_TRIGGER_ADCINT1";
adc2.soc12InterruptTrigger          = "ADC_INT_SOC_TRIGGER_ADCINT1";
adc2.soc13InterruptTrigger          = "ADC_INT_SOC_TRIGGER_ADCINT1";
adc2.soc14InterruptTrigger          = "ADC_INT_SOC_TRIGGER_ADCINT1";
adc2.soc15InterruptTrigger          = "ADC_INT_SOC_TRIGGER_ADCINT1";
adc2.soc16InterruptTrigger          = "ADC_INT_SOC_TRIGGER_ADCINT1"
adc2.soc17InterruptTrigger          = "ADC_INT_SOC_TRIGGER_ADCINT1"
adc2.soc18InterruptTrigger          = "ADC_INT_SOC_TRIGGER_ADCINT1"
adc2.soc19InterruptTrigger          = "ADC_INT_SOC_TRIGGER_ADCINT1"
adc2.soc20InterruptTrigger          = "ADC_INT_SOC_TRIGGER_ADCINT1"
adc2.soc21InterruptTrigger          = "ADC_INT_SOC_TRIGGER_ADCINT1"
adc2.soc22InterruptTrigger          = "ADC_INT_SOC_TRIGGER_ADCINT1"
adc2.soc23InterruptTrigger          = "ADC_INT_SOC_TRIGGER_ADCINT1"
adc2.soc24InterruptTrigger          = "ADC_INT_SOC_TRIGGER_ADCINT1"
adc2.soc25InterruptTrigger          = "ADC_INT_SOC_TRIGGER_ADCINT1"
adc2.soc26InterruptTrigger          = "ADC_INT_SOC_TRIGGER_ADCINT1";
adc2.soc27InterruptTrigger          = "ADC_INT_SOC_TRIGGER_ADCINT1";
adc2.soc28InterruptTrigger          = "ADC_INT_SOC_TRIGGER_ADCINT1";
adc2.soc29InterruptTrigger          = "ADC_INT_SOC_TRIGGER_ADCINT1";
adc2.soc30InterruptTrigger          = "ADC_INT_SOC_TRIGGER_ADCINT1";
adc2.soc31InterruptTrigger          = "ADC_INT_SOC_TRIGGER_ADCINT1";
adc2.enabledInts                    = ["ADC_INT_NUMBER1","ADC_INT_NUMBER2","ADC_INT_NUMBER3","ADC_INT_NUMBER4"];
adc2.enableInterrupt1               = true;
adc2.enableInterrupt2               = true;
adc2.interrupt2SOCSource            = "ADC_INT_TRIGGER_EOC31";
adc2.enableInterrupt1ContinuousMode = true;
adc2.enableInterrupt2ContinuousMode = true;

const analog  = scripting.addModule("/driverlib/analog.js", {}, false);
const analog1 = analog.addInstance({}, false);
analog1.$name = "myANALOGPinMux0";
adc1.analog   = analog1;
adc2.analog   = analog1;

asysctl.analogReferenceAB  = "INTERNAL_3_3_V";
asysctl.analogReferenceCDE = "INTERNAL_3_3_V";
