/**
 * @cliArgs --device "F29H85x" --package "256ZEX" --part "F29H85x_256ZEX" --context "CPU1" --product "MCU_SDK_F29H85x@1.02.02.00"
 * @versions {"tool":"1.25.0+4237"}
 */

    
const divider15       = system.clockTree["PLL_REFDIV"];
divider15.divideValue = 1;

const multiplier1         = system.clockTree["PLL_IMULT"];
multiplier1.multiplyValue = 40;

const mux7       = system.clockTree["OSCCLKSRCSEL"];
mux7.inputSelect = "INTOSC2";

/**
 * Import the modules used in this configuration.
 */
const adc     = scripting.addModule("/driverlib/adc.js", {}, false);
const adc1    = adc.addInstance();
const asysctl = scripting.addModule("/driverlib/asysctl.js");

/**
 * Write custom configuration values to the imported modules.
 */
adc1.$name                    = "myADC0";
adc1.adcClockPrescaler        = "ADC_CLK_DIV_4_0";
adc1.enabledSOCs              = ["ADC_SOC_NUMBER0","ADC_SOC_NUMBER1"];
adc1.soc0Trigger              = "ADC_TRIGGER_EPWM1_SOCA";
adc1.soc0SampleWindow         = 15;
adc1.soc1SampleWindow         = 15;
adc1.soc1Channel              = "ADC_CH_ADCIN1";
adc1.interruptPulseMode       = "ADC_PULSE_END_OF_CONV";
adc1.enabledInts              = ["ADC_INT_NUMBER1","ADC_INT_NUMBER2"];
adc1.enableInterrupt1         = true;
adc1.enableInterrupt2         = true;
adc1.interrupt2SOCSource      = "ADC_INT_TRIGGER_EOC1";
adc1.enabledPPBs              = ["ADC_PPB_NUMBER1"];
adc1.registerInterrupts       = ["1","2"];
adc1.soc1Trigger              = "ADC_TRIGGER_EPWM2_SOCA";
adc1.periphClock.$name        = "driverlib_perClock0";
adc1.periphConfig.$name       = "driverlib_perConfig0";
adc1.adcInt1.interruptHandler = "adcA1ISR";
adc1.adcInt2.interruptHandler = "adcA2ISR";

const analog  = scripting.addModule("/driverlib/analog.js", {}, false);
const analog1 = analog.addInstance({}, false);
analog1.$name = "myANALOGPinMux0";
adc1.analog   = analog1;

asysctl.analogReferenceAB = "INTERNAL_3_3_V";
