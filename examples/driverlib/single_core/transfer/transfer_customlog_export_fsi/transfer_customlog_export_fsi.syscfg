/**
 * @cliArgs --device "F29H85x" --package "256ZEX" --part "F29H85x_256ZEX" --context "CPU1" --product "MCU_SDK_F29H85x@1.02.02.00"
 * @versions {"tool":"1.25.0+4237"}
 */

    
const divider15       = system.clockTree["PLL_REFDIV"];
divider15.divideValue = 1;

const multiplier1         = system.clockTree["PLL_IMULT"];
multiplier1.multiplyValue = 40;

const mux7       = system.clockTree["OSCCLKSRCSEL"];
mux7.inputSelect = "INTOSC2";
/**
 * Import the modules used in this configuration.
 */
const sysctl         = scripting.addModule("/driverlib/sysctl.js");
const gui            = scripting.addModule("/transfer/gui.js");

gui.customlogger                                        = true;
gui.guiProjectName                                      = "transfer_customlog_export_fsi";
gui.exporter.$name                                      = "myEXPORT0";
gui.exporter.exportCustomLogTimestamp                   = true;
gui.exporter.comsLink                                   = "fsi";
gui.exporter.exportLogTimestampModule.periphClock.$name = "driverlib_perClock1";
gui.exporter.comsLinkModule.fsitx.$assign               = "FSITXA";
gui.exporter.comsLinkModule.d0Qual.$name                = "myGPIOQUAL0";
gui.exporter.comsLinkModule.d1Qual.$name                = "myGPIOQUAL1";
gui.exporter.comsLinkModule.clkQual.$name               = "myGPIOQUAL5";
gui.exporter.comsLinkModule.periphClock.$name           = "driverlib_perClock0";
gui.exporter.comsLinkModule.periphConfig.$name          = "driverlib_perConfig0";
