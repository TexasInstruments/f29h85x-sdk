/**
 * @cliArgs --device "F29H85x" --package "256ZEX" --part "F29H85x_256ZEX" --context "CPU1" --product "MCU_SDK_F29H85x@1.02.02.00"
 * @versions {"tool":"1.25.0+4237"}
 */

    
const divider15       = system.clockTree["PLL_REFDIV"];
divider15.divideValue = 1;

const multiplier1         = system.clockTree["PLL_IMULT"];
multiplier1.multiplyValue = 40;

const mux7       = system.clockTree["OSCCLKSRCSEL"];
mux7.inputSelect = "INTOSC2";

/**
 * Import the modules used in this configuration.
 */
const dac  = scripting.addModule("/driverlib/dac.js", {}, false);
const dac1 = dac.addInstance();

/**
 * Write custom configuration values to the imported modules.
 */
dac1.$name              = "myDAC0";
dac1.enableOutput       = true;
dac1.periphClock.$name  = "driverlib_perClock0";
dac1.periphConfig.$name = "driverlib_perConfig0";

const analog  = scripting.addModule("/driverlib/analog.js", {}, false);
const analog1 = analog.addInstance({}, false);
analog1.$name = "myANALOGPinMux0";
dac1.analog   = analog1;
