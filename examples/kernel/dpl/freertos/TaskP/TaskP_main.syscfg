/**
 * @cliArgs --device "F29H85x" --package "256ZEX" --part "F29H85x_256ZEX" --context "CPU1" --product "MCU_SDK_F29H85x@1.02.02.00"
 * @versions {"tool":"1.25.0+4237"}
 */

    
const divider15       = system.clockTree["PLL_REFDIV"];
divider15.divideValue = 1;

const multiplier1         = system.clockTree["PLL_IMULT"];
multiplier1.multiplyValue = 40;

const mux7       = system.clockTree["OSCCLKSRCSEL"];
mux7.inputSelect = "INTOSC2";

/**
 * Import the modules used in this configuration.
 */
const jtag          = scripting.addModule("/driverlib/jtag.js");
const clock_c29_sdk = scripting.addModule("/kernel/dpl/clock_c29_sdk");
const FREERTOS      = scripting.addModule("/kernel/freertos_tool/FREERTOS", {}, false);
const FREERTOS1     = FREERTOS.addInstance();
clock_c29_sdk.rtos                  = "FREERTOS";
clock_c29_sdk.freertos_source.$name = "kernel_dpl_freertos_source0";

FREERTOS1.$name                                        = "myFREERTOS0";
FREERTOS1.USE_MUTEXES                                  = true;
FREERTOS1.USE_RECURSIVE_MUTEXES                        = true;
FREERTOS1.xTaskGetSchedulerState                       = true;
FREERTOS1.USE_TRACE_FACILITY                           = true;
FREERTOS1.vTaskDelete                                  = true;
FREERTOS1.xTimerPendFunctionCall                       = true;
FREERTOS1.USE_TIMERS                                   = true;
FREERTOS1.TIMER_TASK_STACK_DEPTH                       = 512;
FREERTOS1.USE_COUNTING_SEMAPHORES                      = true;
FREERTOS1.xTaskGetIdleTaskHandle                       = true;
FREERTOS1.tickTimer.periphClock.pinmuxPeripheralModule = scripting.forceWrite("");
FREERTOS1.tickTimer.periphClock.$name                  = "driverlib_perClock0";

/**
 * Pinmux solution for unlocked pins/peripherals. This ensures that minor changes to the automatic solver in a future
 * version of the tool will not impact the pinmux you originally saw.  These lines can be completely deleted in order to
 * re-solve from scratch.
 */
jtag.JTAG.$suggestSolution        = "JTAG";
jtag.JTAG.tdoPin.$suggestSolution = "GPIO223/TDO";
jtag.JTAG.tdiPin.$suggestSolution = "GPIO222/TDI";
