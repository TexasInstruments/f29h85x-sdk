/**
 * @cliArgs --device "F29H85x" --package "256ZEX" --part "F29H85x_256ZEX" --context "CPU1" --product "MCU_SDK_F29H85x@1.00.00.00"
 * @versions {"tool":"1.22.0+3877"}
 */

const divider15       = system.clockTree["PLL_REFDIV"];
divider15.divideValue = 1;

const multiplier1         = system.clockTree["PLL_IMULT"];
multiplier1.multiplyValue = 40;

const mux7       = system.clockTree["OSCCLKSRCSEL"];
mux7.inputSelect = "INTOSC2";
 
/**
 * Import the modules used in this configuration.
 */
const FREERTOS  = scripting.addModule("/kernel/freertos_tool/FREERTOS", {}, false);
const FREERTOS1 = FREERTOS.addInstance();

FREERTOS1.$name                                        = "myFREERTOS0";
FREERTOS1.TICK_RATE_HZ                                 = 1000;
FREERTOS1.MAX_PRIORITIES                               = 10;
FREERTOS1.SUPPORT_DYNAMIC_ALLOCATION                   = false;
FREERTOS1.vTaskDelayUntil                              = false;
FREERTOS1.tasks.create(2);
FREERTOS1.tasks[0].taskPointer                         = "Task1";
FREERTOS1.tasks[0].taskStackSize                       = 256;
FREERTOS1.tasks[0].taskPriority                        = 2;
FREERTOS1.tasks[0].$name                               = "myTask1";
FREERTOS1.tasks[1].$name                               = "myTask2";
FREERTOS1.tasks[1].taskPointer                         = "Task2";
FREERTOS1.tasks[1].taskStackSize                       = 256;
FREERTOS1.tasks[1].taskPriority                        = 2;
FREERTOS1.tickTimer.periphClock.$name                  = "driverlib_perClock0";
FREERTOS1.tickTimer.periphClock.pinmuxPeripheralModule = scripting.forceWrite("");
