/**
 * @cliArgs --device "F29H85x" --package "256ZEX" --part "F29H85x_256ZEX" --context "CPU1" --product "MCU_SDK_F29H85x@1.02.02.00"
 * @versions {"tool":"1.25.0+4237"}
 */

    
const divider15       = system.clockTree["PLL_REFDIV"];
divider15.divideValue = 1;

const multiplier1         = system.clockTree["PLL_IMULT"];
multiplier1.multiplyValue = 40;

const mux7       = system.clockTree["OSCCLKSRCSEL"];
mux7.inputSelect = "INTOSC2";

scripting.excludeFromBuild("FreeRTOSConfig.h");

/**
 * Import the modules used in this configuration.
 */
const ipc       = scripting.addModule("/driverlib/ipc.js");
const FREERTOS  = scripting.addModule("/kernel/freertos_tool/FREERTOS", {}, false);
const FREERTOS1 = FREERTOS.addInstance();

/**
 * Write custom configuration values to the imported modules.
 */
ipc.registerInterrupts1       = ["4"];
ipc.ipcInt21.interruptHandler = "ipcInterrupt_fromCPU3";

FREERTOS1.$name                                        = "myFREERTOS0";
FREERTOS1.tasks.create(1);
FREERTOS1.tasks[0].taskPriority                        = 1;
FREERTOS1.tasks[0].$name                               = "TaskSend";
FREERTOS1.tasks[0].taskPointer                         = "task_send";
FREERTOS1.tickTimer.periphClock.$name                  = "driverlib_perClock0";
FREERTOS1.tickTimer.periphClock.pinmuxPeripheralModule = scripting.forceWrite("");
